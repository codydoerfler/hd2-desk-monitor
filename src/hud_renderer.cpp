#include "hud_renderer.h"

#include <math.h>  // the medallion's laurel; nothing else here needs trig

#include "config.h"
#include "hd2_api.h"   // formatDuration / formatCompact
#include "hud_fonts.h" // must be included by exactly one .cpp
#include "hud_icons.h" // generated by tools/gen_icons.py
#include "hud_faction_icons.h" // generated by tools/gen_faction_icons.py
#include "hud_biomes.h" // generated by tools/gen_biomes.py
#include "hud_mo_art.h" // generated by tools/gen_mo_art.py
#include "hud_bulletin_art.h" // generated by tools/gen_bulletin_art.py

using namespace layout;

// ---------------------------------------------------------------------------
//  Icons
// ---------------------------------------------------------------------------

namespace {

struct IconRef {
  const uint8_t *bits;
  int16_t w, h;
};

// A full-colour icon. `px` is RGB565 blitted with pushImage() rather than
// tinted; pixels equal to facicons::kTransparent are left alone, so one of
// these can sit on the alert ribbon as safely as on the panel background.
struct ColorIconRef {
  const uint16_t *px;
  int16_t w, h;
};

// The badge icon for a planet owner. Matched on a lowercased prefix so both
// the singular and plural spellings the API uses ("Automaton", "Terminids")
// land on the same icon.
//
// These three are full-colour RGB565, not 1-bit masks: the official insignia
// read as a lighter facet over a darker body, and that split is the whole
// identity of the Illuminate mark in particular -- reduced to one bit at badge
// size it is a featureless blob. They carry their own colour and are not
// tinted by the caller. See src/hud_faction_icons.h.
//
// There is deliberately no entry for "Humans": the SEAF emblem's detail does
// not survive the reduction to a badge-sized bitmap, so that badge takes the
// same text-only route as an owner we have no icon for at all.
ColorIconRef factionIcon(const String &faction) {
  String f = faction;
  f.toLowerCase();
  if (f.startsWith("automaton"))
    return {facicons::automaton, facicons::automatonW, facicons::automatonH};
  if (f.startsWith("terminid"))
    return {facicons::terminid, facicons::terminidW, facicons::terminidH};
  if (f.startsWith("illuminate"))
    return {facicons::illuminate, facicons::illuminateW, facicons::illuminateH};
  return {nullptr, 0, 0};  // SEAF / unknown owner: badge falls back to text only
}

// One chip per hazard kind. hazardFromName() in hd2_model.h has already turned
// the API's free-text hazard name into one of these; kHazardOther is the
// catch-all that keeps an unrecognised hazard visible rather than dropped.
IconRef hazardIcon(HazardKind k) {
  switch (k) {
    case kHazardFire:   return {icons::hazFire, icons::hazFireW, icons::hazFireH};
    case kHazardIon:    return {icons::hazIon, icons::hazIonW, icons::hazIonH};
    case kHazardCold:   return {icons::hazCold, icons::hazColdW, icons::hazColdH};
    case kHazardMeteor: return {icons::hazMeteor, icons::hazMeteorW, icons::hazMeteorH};
    case kHazardStorm:  return {icons::hazStorm, icons::hazStormW, icons::hazStormH};
    case kHazardTremor: return {icons::hazTremor, icons::hazTremorW, icons::hazTremorH};
    default:            return {icons::hazOther, icons::hazOtherW, icons::hazOtherH};
  }
}

// Source coordinate, in 24.8 fixed point, for destination pixel `d` when
// scaling `dstLen` pixels down onto `srcLen`. Half-pixel centred, so the
// interpolation is symmetric, and clamped at the left/top edge where the
// centring would otherwise read off the start of the array.
inline int32_t srcCoord(int32_t d, int32_t srcLen, int32_t dstLen) {
  const int32_t f = ((2 * d + 1) * srcLen * 256) / (2 * dstLen) - 128;
  return f < 0 ? 0 : f;
}

// Blend two RGB565 pixels, `t` running 0..255 from `a` to `b`. The channels are
// interpolated in their packed 5/6/5 precision, which is all the panel can show
// anyway.
inline uint16_t lerp565(uint16_t a, uint16_t b, int t) {
  const int ar = a >> 11, ag = (a >> 5) & 0x3F, ab = a & 0x1F;
  const int br = b >> 11, bg = (b >> 5) & 0x3F, bb = b & 0x1F;
  return (uint16_t)(((ar + (((br - ar) * t) >> 8)) << 11) |
                    ((ag + (((bg - ag) * t) >> 8)) << 5) |
                     (ab + (((bb - ab) * t) >> 8)));
}

}  // namespace

// ---------------------------------------------------------------------------
//  Small helpers
// ---------------------------------------------------------------------------

static String upper(const String &s) {
  String t = s;
  t.toUpperCase();
  return t;
}

// Humans holding a planet is good news; anyone else gets the red treatment.
static uint16_t factionColor(const String &faction) {
  return faction.equalsIgnoreCase("Humans") ? theme::green : theme::red;
}

// What to *call* a faction on screen. The API names our side "Humans"; the
// game calls them the SEAF, and that is what the card should say. Purely a
// relabelling at the point of drawing — every match above and in hd2_api.cpp
// still runs against the API's own spelling, which this never rewrites.
static String factionDisplayName(const String &faction) {
  String f = faction;
  f.toLowerCase();
  return f.startsWith("human") ? String(F("SEAF")) : faction;
}

// The card's accent, taken from whoever is attacking. Everything tinted by it
// — the alert ribbon, the scene weave, the invader's half of the tug-of-war —
// is describing that faction, so they all move together.
static uint16_t factionAccent(const String &faction) {
  String f = faction;
  f.toLowerCase();
  if (f.startsWith("illuminate")) return theme::purple;
  if (f.startsWith("terminid")) return theme::amber;
  if (f.startsWith("automaton")) return theme::red;
  if (f.startsWith("human")) return theme::blue;
  return theme::gold;
}

// Anchor point inside a w*h box for a given TFT_eSPI datum.
static void datumAnchor(uint8_t datum, int16_t w, int16_t h, int16_t &ax, int16_t &ay) {
  switch (datum) {
    case TC_DATUM: ax = w / 2; ay = 0;     break;
    case TR_DATUM: ax = w;     ay = 0;     break;
    case ML_DATUM: ax = 0;     ay = h / 2; break;
    case MC_DATUM: ax = w / 2; ay = h / 2; break;
    case MR_DATUM: ax = w;     ay = h / 2; break;
    default:       ax = 0;     ay = 0;     break;  // TL_DATUM
  }
}

// "Omega" -> "OMEGA SECTOR". The API gives the bare name; the card wants the
// full form the game uses.
static String sectorLabel(const String &sector) {
  if (!sector.length()) return String();
  String s = upper(sector);
  if (!s.endsWith(" SECTOR")) s += F(" SECTOR");
  return s;
}

// Player counts, grouped: 13637 -> "13,637".
//
// This used to zero-pad to six digits ("013,637") so the footer's left block
// kept a constant width and did not twitch as divers came and went. The
// padding read as part of the number rather than as alignment, so it is gone;
// the callers hold their own width instead — the strip's fixed column boxes
// now, the footer's own having gone with the diver count it cleared for.
// Width to clear for the footer's reward, in FONT_VALUE. Four digits is well
// past any medal award the game has issued, but the row has the space and a
// clipped number is a worse failure than a wide box; holding the box fixed
// also keeps a drop from 120 to 45 from leaving the hundreds digit standing.
static constexpr int16_t kRewardBoxW = 56;

// The footer's reward block, end to end, and the gap it leaves before the sync
// clock. That gap is where the uncalibrated-touch hint goes: it was left empty
// deliberately when the footer was reworked, and this is a caption that earns
// it -- a call to action that removes itself the moment it is acted on.
// Derived rather than declared so it cannot drift from the block beside it.
static constexpr int16_t kRewardBlockW = icons::medalW + footerIconGap + kRewardBoxW;
static constexpr int16_t kHintX = cardX + kRewardBlockW;
static constexpr int16_t kHintW = (contentR - syncBoxW) - kHintX;

static String formatCount(uint32_t v) {
  char digits[16];
  snprintf(digits, sizeof(digits), "%lu", (unsigned long)v);
  const int n = (int)strlen(digits);
  String out;
  out.reserve(n + n / 3);
  for (int i = 0; i < n; i++) {
    if (i && (n - i) % 3 == 0) out += ',';
    out += digits[i];
  }
  return out;
}

// A measured rate of change, e.g. "+04.426% / h". Zero-padded to a fixed width
// for the same reason as the player count.
static String formatRate(float pctPerHour) {
  float a = fabsf(pctPerHour);
  if (a > 99.999f) a = 99.999f;  // clamp rather than let the field jump width
  char buf[24];
  snprintf(buf, sizeof(buf), "%c%.1f%% / h", pctPerHour < 0.0f ? '-' : '+', a);
  return String(buf);
}

// The target currently on screen, or nullptr when the order has no tasks.
static const OrderTask *activeTask(const HudModel &m, uint8_t idx) {
  if (!m.order.valid || m.order.taskCount <= 0) return nullptr;
  if (idx >= (uint8_t)m.order.taskCount) idx = 0;
  return &m.order.tasks[idx];
}

// Pages in the unified carousel. An active Major Order owns the screen: High
// Command's orders are the point of the device, and rotating away from them
// to show a planet nobody was told to take buries the one thing that matters.
// The campaign cards are what fills the carousel when there is no order, not
// a second act alongside one. _pageIdx indexes whichever sequence is live;
// these two helpers are how every call site splits it back apart.
// Card pages an active order contributes. An order with no planet-scoped
// targets still gets one: drawCard() has a "ORDER HAS NO TARGETS" state for
// exactly that, and it is more honest than dropping to the idle screen that
// says there is no order at all.
static uint8_t orderPageCount(const HudModel &m) {
  if (!m.order.valid) return 0;
  return m.order.taskCount > 0 ? (uint8_t)m.order.taskCount : 1;
}

static uint8_t pageCount(const HudModel &m) {
  const uint8_t mo = orderPageCount(m);
  return mo > 0 ? mo : m.campaignCount;
}

// Whether page `idx` of the live sequence is a Major Order task card (vs. a
// campaign card, or nothing at all when idx is past the end).
static bool pageIsCard(const HudModel &m, uint8_t idx) {
  return idx < orderPageCount(m);
}

// --- Rates ------------------------------------------------------------------
//
// Everything the card says about *change* is measured here, by diffing the
// current poll against the sample the poll loop kept from the previous one.
// The API has no rate field; without two samples there is no number, and the
// card is expected to say so rather than print a zero.
struct CardRates {
  bool have = false;   // is there a usable pair of samples at all
  float pct = 0.0f;    // percentage points per hour on the leading bar
};

static CardRates cardRates(const HudModel &m, uint8_t idx, const OrderTask &t) {
  CardRates r;
  if (idx >= (uint8_t)kMaxOrderTasks) return r;
  const PlanetInfo &p = t.planet;
  const RateSample &h = m.history[idx];
  if (!p.valid || !h.valid || h.planetIndex != p.index) return r;

  if (p.event.active) {
    // Only against the same defence. When one event ends and another begins the
    // health pair restarts, and diffing across that would report a swing that
    // never happened.
    if (!h.haveEvent || h.eventEnd != p.event.endTime) return r;
    r.have = ratePerHour(p.event.defended(), p.observedAt, h.eventPct, h.at, r.pct);
  } else if (taskIsLiberation(t.taskType)) {
    r.have = ratePerHour(p.liberation, p.observedAt, h.libPct, h.at, r.pct);
  }
  return r;
}

// The %-per-hour a count-style objective is moving at, measured the same way
// cardRates() measures the planet ones — by diffing consecutive polls — but
// from the assignment payload's own progress rather than planet health, and so
// available even when the task's planet is not.
//
// Deliberately not folded into cardRates(): the stat strip's PUSH/REGEN columns
// describe the *planet*, and handing them an objective's rate would quote a
// push figure for a planet whose health is not moving at all.
static CardRates countRate(const HudModel &m, uint8_t idx, const OrderTask &t) {
  CardRates r;
  if (idx >= (uint8_t)kMaxOrderTasks || !taskIsCount(t)) return r;
  const RateSample &h = m.history[idx];
  if (!h.haveCount) return r;
  r.have = ratePerHour(taskPercent(t), m.lastSuccess, h.countPct, h.countAt, r.pct);
  return r;
}

// What a count-style task is counting, in the three places the card names it.
// Only the wording keys off the type code — whether a task gets a progress bar
// at all is decided by its goal (see taskIsCount) — so an objective type this
// build has never seen still renders real progress, just under a generic
// label. Getting the wording wrong costs a word; getting the bar wrong costs
// the whole card, which is the trade this split exists to make.
struct CountWords {
  const char *header;    // header row's type word
  const char *track;     // track caption, before the running total
  const char *headline;  // headline verb, after the percentage
};

static CountWords countWords(int32_t taskType) {
  switch (taskType) {
    case kTaskTypeExtract:    return {"EXTRACTION",  "EXTRACTED",  "EXTRACTED"};
    case kTaskTypeEradicate:  return {"ERADICATION", "ELIMINATED", "ELIMINATED"};
    case kTaskTypeOperations: return {"OPERATIONS",  "OPERATIONS", "COMPLETE"};
    default:                  return {"OBJECTIVE",   "PROGRESS",   "COMPLETE"};
  }
}

// Everything that, when it changes, warrants a full body repaint. The clocks,
// WiFi dot and footer are deliberately excluded — they update themselves
// through their own small sprites, and so are the MO card and the campaign
// card, which carry their own per-page signatures below because the carousel
// repaints just the active card on each advance rather than the whole frame.
static String contentSignature(const HudModel &m) {
  if (!m.haveData) return F("boot");
  String s;
  s.reserve(128);
  if (m.order.valid) {
    // An active order owns the screen, so nothing about the campaigns feed
    // can change what is drawn — it stays out of the signature entirely
    // rather than repainting the card every time the galaxy reshuffles.
    s = F("mo|");
    s += String(m.order.id);
    s += '|';
    s += String(m.order.taskCount);
    return s;
  }

  // War totals only feed the true idle screen's tiles (no order, no
  // campaigns either) — the campaign card's own SHARE stat also reads
  // m.war.playerCount, but that's tracked by campaignPageSignature() below
  // instead, so it doesn't have to force a full-frame repaint on its own.
  s = F("idle|");
  s += String(m.war.playerCount);
  s += '|';
  s += String(m.war.missionSuccessRate);
  s += '|';
  s += formatCompact(m.war.totalKills);

  // Which planets made the top N (and the count going to/from zero) has to
  // force a full repaint the way the order identity does. Per-campaign
  // liberation/player-count churn is deliberately left out — that's
  // campaignPageSignature()'s job, the same split contentSignature() and
  // targetSignature() already have for the MO card.
  s += F("|camp|");
  s += String(m.campaignCount);
  for (uint8_t i = 0; i < m.campaignCount; i++) {
    s += '|';
    s += String(m.campaigns[i].index);
  }
  return s;
}

// Everything the card draws, including which target it is. The two observation
// timestamps stand in for the derived rates: they are what those are computed
// from, and they move exactly when the rates do.
static String targetSignature(const HudModel &m, uint8_t idx) {
  const OrderTask *t = activeTask(m, idx);
  if (!t) return F("none");
  const PlanetInfo &p = t->planet;
  String s;
  s.reserve(160);
  s = String(idx);
  s += '/';
  s += String(m.order.taskCount);
  s += '|';
  s += m.order.title;
  s += '|';
  s += String(m.order.rewardAmount);
  s += '|';
  s += String(t->taskType);
  s += '|';
  s += String(t->planetIndex);
  s += '|';
  s += t->complete ? '1' : '0';
  s += '|';
  // A count task's progress moves every poll while its planet record sits
  // perfectly still, so without these the card would draw its first percentage
  // and then never repaint. Percent is carried at 1/100th resolution rather
  // than the raw total to keep the whole signature inside Arduino String's
  // 32-bit numeric formatting; a billion-kill goal still moves several hundred
  // of those steps between two five-minute polls.
  s += String((int)(taskPercent(*t) * 100.0f));
  s += '|';
  s += formatCompact(t->goal);
  s += '|';
  s += String((unsigned long)m.history[idx < kMaxOrderTasks ? idx : 0].countAt);
  s += '|';
  s += p.name;
  s += '|';
  s += p.sector;
  s += '|';
  s += p.biome;
  s += '|';
  s += p.owner;
  s += '|';
  s += String(p.playerCount);
  s += '|';
  s += String((int)(p.liberation * 100.0f));
  s += '|';
  s += String((unsigned long)p.observedAt);
  s += '|';
  s += String((unsigned long)m.history[idx < kMaxOrderTasks ? idx : 0].at);
  s += '|';
  for (uint8_t i = 0; i < p.hazardCount; i++) s += (char)('0' + (int)p.hazards[i]);
  s += '|';
  if (p.event.active) {
    s += p.event.faction;
    s += '@';
    s += String((unsigned long)p.event.endTime);
    s += '@';
    s += String((int)(p.event.defended() * 100.0f));
  }
  return s;
}

// The campaign-card equivalent of targetSignature() above: everything one
// campaign card draws, so an advance within the campaign half of the
// carousel only repaints the card, not the whole frame. Includes m.war.playerCount
// since the card's SHARE stat reads it directly.
static String campaignPageSignature(const HudModel &m, uint8_t idx) {
  if (idx >= m.campaignCount) return F("none");
  const PlanetInfo &p = m.campaigns[idx];
  String s;
  s.reserve(112);
  s = String(idx);
  s += '/';
  s += String(m.campaignCount);
  s += '|';
  s += p.name;
  s += '|';
  s += p.sector;
  s += '|';
  s += p.biome;
  s += '|';
  s += p.owner;
  s += '|';
  s += String(p.playerCount);
  s += '|';
  s += String((int)(p.liberation * 1000.0f));
  s += '|';
  s += String((unsigned long)p.observedAt);
  s += '|';
  s += String((unsigned long)m.campaignHistory[idx].at);
  s += '|';
  s += String(m.war.playerCount);
  return s;
}

// The status line for an objective that cannot honestly be shown as a
// percentage: defend tasks with nothing attacking them, and any type we don't
// recognise.
struct StatusLine {
  String text;
  uint16_t color;
};

static StatusLine objectiveStatus(const OrderTask &t) {
  if (taskIsCount(t)) {
    // A count task always has an honest percentage of its own, so it never
    // needs the neutral fallback below — and must not get it, since that
    // branch reads "OBJECTIVE COMPLETE" off a flag that only means "started".
    // Green once the goal is met, because the API keeps counting past it and
    // the percentage alone would sit at 100% looking unfinished.
    char buf[24];
    snprintf(buf, sizeof(buf), "%.1f%% %s", taskPercent(t), countWords(t.taskType).headline);
    return {String(buf), t.complete ? theme::green : theme::gold};
  }
  if (t.taskType == kTaskTypeDefend) {
    // Defence is pass/fail per task, and the API says which it is. The planet's
    // health only tells us whether an assault is in progress right now.
    if (t.complete) return {String(F("HELD")), theme::green};
    if (!t.planet.valid) return {String(F("AT RISK")), theme::gold};
    return t.planet.owner.equalsIgnoreCase("Humans")
               ? StatusLine{String(F("STANDING BY")), theme::gold}
               : StatusLine{String(F("LOST")), theme::red};
  }
  // Unknown objective kind: report the one thing the API is unambiguous about
  // rather than inventing a metric for it.
  return t.complete ? StatusLine{String(F("OBJECTIVE COMPLETE")), theme::green}
                    : StatusLine{String(F("IN PROGRESS")), theme::gold};
}

// Geometry of the three icon tiles the no-order screen uses, and of the two-up
// boxes on the WiFi setup screen.
static constexpr int16_t kTileW = (contentW - 2 * tileGap) / 3;  // 142
static constexpr int16_t kStatW = (contentW - statGap) / 2;      // 216
static constexpr int16_t kStatInsetX = 12;
static constexpr int16_t kStatValueDy = 21;
static constexpr int16_t kStatValueH = 20;

// How long each page of the unified carousel (MO task cards, then campaign
// cards) stays on screen. Long enough to read a card and glance away; short
// enough that even a full lap (task cards + up to 5 campaigns) comes round
// inside a normal look at the desk.
static const uint32_t kCarouselCycleMs = 7000;

// ---------------------------------------------------------------------------
//  Lifecycle
// ---------------------------------------------------------------------------

void HUDRenderer::begin() {
  _tft.init();
  // Rotation 1 turns the native 320x480 portrait panel into 480x320 landscape.
  // If the image is upside down for how the board sits on your desk, use 3.
  _tft.setRotation(1);
  _tft.fillScreen(theme::bg);

  // TFT_BL is driven by TFT_eSPI when TFT_BL is defined, but do it explicitly
  // so the backlight is on even if that define is later removed.
#ifdef TFT_BL
  pinMode(TFT_BL, OUTPUT);
  digitalWrite(TFT_BL, TFT_BACKLIGHT_ON);
#endif

  _pageSwitchMs = millis();
  invalidate();
}

void HUDRenderer::invalidate() {
  _chromeDrawn = false;
  _headerSig = "";
  _contentSig = "";
  _targetSig = "";
  _campaignSig = "";
  _clockSig = "";
  _footerSig = "";
  _wifiSig = -1;
}

// ---------------------------------------------------------------------------
//  Primitives
// ---------------------------------------------------------------------------

void HUDRenderer::textBox(int16_t x, int16_t y, int16_t w, int16_t h, uint16_t bg,
                          const GFXfont *font, uint16_t fg, uint8_t datum,
                          const String &s, int16_t inset) {
  TFT_eSprite spr(&_tft);
  spr.setColorDepth(16);
  if (spr.createSprite(w, h)) {
    spr.fillSprite(bg);
    spr.setFreeFont(font);
    spr.setTextColor(fg, bg);
    spr.setTextDatum(datum);
    int16_t ax, ay;
    datumAnchor(datum, w, h, ax, ay);
    if (datum == TL_DATUM || datum == ML_DATUM) ax += inset;
    if (datum == TR_DATUM || datum == MR_DATUM) ax -= inset;
    spr.drawString(s.c_str(), ax, ay);
    spr.pushSprite(x, y);
    spr.deleteSprite();
    return;
  }
  // Sprite allocation failed (heap pressure) — fall back to direct drawing.
  // Slight flicker, but never a blank region.
  _tft.fillRect(x, y, w, h, bg);
  _tft.setFreeFont(font);
  _tft.setTextColor(fg, bg);
  _tft.setTextDatum(datum);
  int16_t ax, ay;
  datumAnchor(datum, w, h, ax, ay);
  if (datum == TL_DATUM || datum == ML_DATUM) ax += inset;
  if (datum == TR_DATUM || datum == MR_DATUM) ax -= inset;
  _tft.drawString(s.c_str(), x + ax, y + ay);
}

// A biome plate, bilinearly scaled up into `dw x dh`. The plates are stored at
// half size (see tools/gen_biomes.py) precisely because this scaler exists, so
// the set fits in flash.
//
// `scrimW` darkens the plate from its left edge inward, ramping from
// `scrimMax` (0-255, blended toward black) back to the untouched artwork. The
// identity is set over that side of the plate, and a photograph is the one
// background text cannot be trusted against: the darkening is applied here,
// while each pixel is already being computed, rather than as a second pass.
void HUDRenderer::drawBiome(const uint16_t *src, int16_t sw, int16_t sh, int16_t dx,
                            int16_t dy, int16_t dw, int16_t dh, int16_t scrimW,
                            uint8_t scrimMax) {
  if (!src || dw <= 0 || dh <= 0) return;

  // pushImage() streams the buffer straight at the panel, which wants each
  // pixel MSB first; the words below are native-endian.
  const bool swap = _tft.getSwapBytes();
  _tft.setSwapBytes(true);

  uint16_t line[cardW];
  const int16_t span = dw > cardW ? cardW : dw;
  for (int16_t j = 0; j < dh; ++j) {
    const int32_t fy = srcCoord(j, sh, dh);
    const int32_t y0 = fy >> 8;
    const int32_t y1 = (y0 + 1 < sh) ? y0 + 1 : y0;
    const int ty = fy & 0xFF;
    const uint16_t *r0 = &src[y0 * sw];
    const uint16_t *r1 = &src[y1 * sw];

    for (int16_t i = 0; i < span; ++i) {
      const int32_t fx = srcCoord(i, sw, dw);
      const int32_t x0 = fx >> 8;
      const int32_t x1 = (x0 + 1 < sw) ? x0 + 1 : x0;
      const int tx = fx & 0xFF;
      uint16_t px =
          lerp565(lerp565(pgm_read_word(&r0[x0]), pgm_read_word(&r0[x1]), tx),
                  lerp565(pgm_read_word(&r1[x0]), pgm_read_word(&r1[x1]), tx),
                  ty);
      if (scrimW > 0 && i < scrimW) {
        const int t = (int)scrimMax * (scrimW - i) / scrimW;
        px = lerp565(px, 0x0000, t);  // toward black
      }
      line[i] = px;
    }
    _tft.pushImage(dx, dy + j, span, 1, line);
  }

  _tft.setSwapBytes(swap);
}

// Text straight onto whatever is already on the panel. textBox() fills its
// sprite with a flat colour, which would punch a hole in the artwork, so the
// identity set over the biome comes through here instead.
void HUDRenderer::drawOverText(int16_t x, int16_t y, int16_t h, const GFXfont *font,
                               uint16_t fg, const String &s) {
  if (h <= 0 || !s.length()) return;
  _tft.setFreeFont(font);
  _tft.setTextColor(fg);  // no bg colour == glyphs only, art shows through
  _tft.setTextDatum(ML_DATUM);
  _tft.drawString(s.c_str(), x, y + h / 2);
}

void HUDRenderer::drawRule(int16_t y) {
  _tft.drawFastHLine(padX, y, contentW, theme::goldDim);
}

int16_t HUDRenderer::tileX(int i) {
  return padX + i * (kTileW + tileGap);
}

void HUDRenderer::drawTile(int i, const uint8_t *icon, int16_t iw, int16_t ih,
                           const String &value, uint16_t valueColor) {
  const int16_t x = tileX(i);
  _tft.fillRect(x, tileY, kTileW, tileH, theme::panel);
  _tft.drawRect(x, tileY, kTileW, tileH, theme::goldDim);
  // The icon stands in for what used to be an ALL-CAPS label, so it is drawn
  // at label weight rather than value weight.
  _tft.drawBitmap(x + tileInsetX, tileY + tileIconDy, icon, iw, ih, theme::goldDim);

  // Drop a size rather than run off the edge of the tile.
  _tft.setFreeFont(FONT_VALUE);
  const GFXfont *font = (_tft.textWidth(value.c_str()) > kTileW - 2 * tileInsetX)
                            ? FONT_LABEL
                            : FONT_VALUE;
  textBox(x + 1, tileY + tileValueDy, kTileW - 2, tileValueH, theme::panel, font,
          valueColor, ML_DATUM, value, tileInsetX - 1);
}

void HUDRenderer::drawStatBox(int16_t x, int16_t y, int16_t w, int16_t h,
                              const String &label, const String &value,
                              uint16_t valueColor) {
  _tft.fillRect(x, y, w, h, theme::panel);
  _tft.drawRect(x, y, w, h, theme::goldDim);
  textBox(x + 1, y + 5, w - 2, 15, theme::panel, FONT_LABEL, theme::grey, ML_DATUM,
          label, kStatInsetX - 1);

  // Drop a size rather than run off the edge of the box (long values show up
  // in the WiFi-setup screen, and for very large player counts).
  _tft.setFreeFont(FONT_VALUE);
  const GFXfont *valueFont =
      (_tft.textWidth(value.c_str()) > w - 2 * kStatInsetX) ? FONT_LABEL : FONT_VALUE;
  textBox(x + 1, y + kStatValueDy, w - 2, kStatValueH, theme::panel, valueFont,
          valueColor, ML_DATUM, value, kStatInsetX - 1);
}

int16_t HUDRenderer::badgeWidth(const String &faction) {
  const String label = upper(faction.length() ? factionDisplayName(faction)
                                              : String("UNKNOWN"));
  const ColorIconRef ic = factionIcon(faction);

  _tft.setFreeFont(FONT_LABEL);
  int16_t w = _tft.textWidth(label.c_str()) + 2 * badgePadX;
  if (ic.px) w += ic.w + badgeIconGap;
  return w > badgeMaxW ? badgeMaxW : w;
}

void HUDRenderer::drawBadge(const String &faction, int16_t x, int16_t y, int16_t h) {
  const String label = upper(faction.length() ? factionDisplayName(faction)
                                              : String("UNKNOWN"));
  const uint16_t c = factionColor(faction);
  const ColorIconRef ic = factionIcon(faction);
  const int16_t w = badgeWidth(faction);

  _tft.fillRect(x, y, w, h, theme::bg);
  _tft.drawRect(x, y, w, h, c);

  if (ic.px) {
    // Icon then label, left-aligned as a pair. Since the badge is sized to
    // fit exactly, that reads as centred. textBox() clears the icon slot on
    // its way past, so the bitmap goes down afterwards.
    textBox(x + 1, y + 1, w - 2, h - 2, theme::bg, FONT_LABEL, c, ML_DATUM, label,
            badgePadX + ic.w + badgeIconGap - 1);
    // The icon arrays are plain uint16_t, so on a little-endian ESP32 they
    // reach the panel byte-reversed unless this is set -- which turns the
    // Automaton's salmon into a pale blue. headerBg never hit this because it
    // goes out through drawPixel(), a pixel at a time.
    _tft.setSwapBytes(true);
    _tft.pushImage(x + badgePadX, y + (h - ic.h) / 2, ic.w, ic.h, ic.px,
                   facicons::kTransparent);
    _tft.setSwapBytes(false);
  } else {
    textBox(x + 1, y + 1, w - 2, h - 2, theme::bg, FONT_LABEL, c, MC_DATUM, label);
  }
}

void HUDRenderer::drawTrack(int16_t y, int16_t h, float pct, uint16_t fill) {
  const float clamped = pct < 0.0f ? 0.0f : (pct > 100.0f ? 100.0f : pct);
  const int16_t fillW = (int16_t)((cardW - 2) * (clamped / 100.0f) + 0.5f);

  _tft.fillRect(cardX, y, cardW, h, theme::track);
  if (fillW > 0) _tft.fillRect(cardX + 1, y + 1, fillW, h - 2, fill);
  _tft.drawRect(cardX, y, cardW, h, theme::cardEdge);

  // Chevron cap riding the leading edge of the fill, once there is room for it
  // to sit inside the fill rather than straddle the track.
  if (fillW > icons::trendW + 6 && h >= icons::trendH + 2) {
    _tft.drawBitmap(cardX + 1 + fillW - icons::trendW - 3, y + (h - icons::trendH) / 2,
                    icons::trend, icons::trendW, icons::trendH, theme::text);
  }
}

// A track and the caption row above it: what the track measures on the left,
// its value and rate on the right. The readout sits above the bar rather than
// beside it because the track now runs the full content width — there is no
// column left over, and a bar that stops short to make one reads as a bar
// that is less full than it is.
void HUDRenderer::drawBarRow(int16_t capY, int16_t barY, int16_t barH,
                             const String &label, const String &readout,
                             uint16_t readoutColor, float pct, uint16_t fill) {
  textBox(cardX, capY, cardW / 2, barCapH, theme::bg, nullptr, theme::grey, ML_DATUM,
          label);
  textBox(cardX + cardW / 2, capY, cardW / 2, barCapH, theme::bg, nullptr, readoutColor,
          MR_DATUM, readout);
  drawTrack(barY, barH, pct, fill);
}

void HUDRenderer::drawIdleTrack(int16_t capY, int16_t barY, int16_t barH,
                                const String &label) {
  _tft.fillRect(cardX, capY, cardW, barCapH, theme::bg);
  _tft.fillRect(cardX, barY, cardW, barH, theme::track);
  _tft.drawRect(cardX, barY, cardW, barH, theme::cardEdge);
  textBox(cardX + 1, barY + 1, cardW - 2, barH - 2, theme::track, FONT_LABEL,
          theme::grey, MC_DATUM, label);
}

// ---------------------------------------------------------------------------
//  Chrome — outer frame, corner brackets, header row
// ---------------------------------------------------------------------------

void HUDRenderer::drawFrame() {
  const int16_t x0 = frameX, y0 = frameY;
  const int16_t x1 = frameX + frameW - 1, y1 = frameY + frameH - 1;

  _tft.drawRect(x0, y0, frameW, frameH, theme::goldDim);

  // Squared-off corner accents: two arms per corner, brighter and thicker
  // than the frame itself.
  const int16_t L = bracketLen, T = bracketThick;
  // top-left
  _tft.fillRect(x0, y0, L, T, theme::gold);
  _tft.fillRect(x0, y0, T, L, theme::gold);
  // top-right
  _tft.fillRect(x1 - L + 1, y0, L, T, theme::gold);
  _tft.fillRect(x1 - T + 1, y0, T, L, theme::gold);
  // bottom-left
  _tft.fillRect(x0, y1 - T + 1, L, T, theme::gold);
  _tft.fillRect(x0, y1 - L + 1, T, L, theme::gold);
  // bottom-right
  _tft.fillRect(x1 - L + 1, y1 - T + 1, L, T, theme::gold);
  _tft.fillRect(x1 - T + 1, y1 - L + 1, T, L, theme::gold);
}

int16_t HUDRenderer::drawLibcon(int16_t x, int16_t y, int16_t h, int8_t tier) {
  if (tier < 1 || tier > 5) return x;
  // Matches the community app's own LIBCON legend: 1 white, 2 red, 3 yellow,
  // 4 green, 5 blue.
  static const uint16_t kTierColor[6] = {
      0, theme::text, theme::red, theme::gold, theme::green, theme::blue,
  };
  const uint16_t fill = kTierColor[tier];
  // White and yellow/green fills need dark ink; red and blue read better with
  // light ink.
  const uint16_t ink = (tier == 2 || tier == 5) ? theme::text : theme::bg;
  const int16_t cy = y + (h - libconH) / 2;
  _tft.fillRect(x, cy, libconW, libconH, fill);
  _tft.drawRect(x, cy, libconW, libconH, theme::bg);
  char label[12];
  snprintf(label, sizeof(label), "LIBCON %d", tier);
  textBox(x, cy, libconW, libconH, fill, FONT_LABEL, ink, MC_DATUM, label);
  return x + libconW;
}

// The header row, shared by every screen: what kind of objective this is, the
// LIBCON chip beside it, the carousel pips, and (from drawWifi) the link
// state at the right. The chip moved up here from the footer when the cards
// were rebuilt around the artwork -- the footer row it used to share with the
// sync line no longer had the clearance, and the reading belongs next to the
// objective type it qualifies anyway.
void HUDRenderer::drawStatusHeader(const String &title, int8_t tier, uint8_t pages,
                                   uint8_t page) {
  const String label = title.length() ? title : String(F("SUPER EARTH"));

  _tft.setFreeFont(FONT_LABEL);
  const int16_t labelW = _tft.textWidth(label.c_str());
  // Cleared across the whole row up to the WiFi slot, not to the label's own
  // width. Everything drawn after this -- the chip, the pips -- is positioned
  // off labelW, so a long type word giving way to a short one ("EXTERMINATION"
  // to "DEFENSE" as the carousel advances) slides them left and would strand
  // the previous frame's copies to the right of the new ones. A fixed 200 was
  // wide enough for the label's own tail and nothing else, which was invisible
  // while this row was only ever painted onto a freshly-cleared screen.
  textBox(padX, headerY, contentW - wifiSlotW, headerH, theme::bg, FONT_LABEL,
          theme::gold, ML_DATUM, label);

  int16_t x = padX + labelW + libconGapX;
  if (tier >= 1 && tier <= 5) x = drawLibcon(x, headerY, headerH, tier);

  // Carousel position, just past the chip. Only drawn when there is more than
  // one page -- a single dot says nothing a blank row does not.
  //
  // The active pip is a filled square at full size against hollow outlines two
  // pixels smaller all round, rather than same-size filled-vs-hollow: at this
  // size the fill alone was a difference you had to go looking for from a desk
  // away, and the one thing this row exists to say is which page you are on.
  if (pages > 1) {
    x += pipRowGap;
    for (uint8_t i = 0; i < pages; i++, x += pipS + pipGap) {
      if (i == page) {
        _tft.fillRect(x, headerY + (headerH - pipS) / 2, pipS, pipS, theme::gold);
      } else {
        const int16_t s = pipS - 2 * pipDimInset;
        _tft.drawRect(x + pipDimInset, headerY + (headerH - s) / 2, s, s,
                      theme::goldDim);
      }
    }
  }

  drawRule(rule1Y);
}

// What the header row is currently saying, and the repaint that keeps it true.
//
// Split out of drawBody() because drawBody() is not what runs when the
// carousel advances: a page step inside one Major Order leaves
// contentSignature() unchanged, so update() repaints the card alone and this
// row kept whatever it was painted with at the last full repaint. The pips
// therefore never moved on hardware, and the objective-type word beside them
// was equally stale -- an advance from a liberation target to a defence one
// left "LIBERATION" over a defence card. Signature-guarded so calling it every
// frame costs one string compare.
void HUDRenderer::drawHeader(const HudModel &m) {
  const uint8_t pages = pageCount(m);
  const bool cardPage = pageIsCard(m, _pageIdx);

  // The type word is what changes -- an order card names its objective, a
  // campaign card is always a liberation, and the screens with no card keep
  // the plain strip.
  String type;
  if (m.haveData) {
    if (cardPage) {
      const OrderTask *t = activeTask(m, _pageIdx);
      const bool defending =
          t && ((t->taskType == kTaskTypeDefend) || t->planet.event.active);
      const bool liberating = t && taskIsLiberation(t->taskType);
      // Same precedence the card body uses: a count objective names itself
      // even when its planet happens to be under attack, because the count is
      // what the order is asking for.
      if (t && taskIsCount(*t)) type = countWords(t->taskType).header;
      else type = defending ? F("DEFENSE") : (liberating ? F("LIBERATION") : F("OBJECTIVE"));
    } else if (pages > 0) {
      type = F("LIBERATION");
    }
  }

  const int8_t tier = m.haveData ? libconTier(m) : 0;
  const String sig =
      type + "|" + String((int)tier) + "|" + String((int)pages) + "|" + String((int)_pageIdx);
  if (sig == _headerSig) return;
  _headerSig = sig;

  drawStatusHeader(type, tier, pages, _pageIdx);
}

void HUDRenderer::drawWifi(bool up) {
  const int8_t sig = up ? 1 : 0;
  if (sig == _wifiSig) return;
  _wifiSig = sig;

  const uint16_t c = up ? theme::green : theme::red;
  const int16_t dotR = footDotR;
  const int16_t dotCx = contentR - dotR;
  const int16_t cy = headerY + headerH / 2;
  const char *label = up ? "WIFI" : "OFFLINE";

  // Label right-aligned just left of the dot. The slot width is shared with
  // drawStatusHeader(), which clears the rest of the row up to its left edge.
  textBox(contentR - wifiSlotW, headerY, wifiSlotW - (2 * dotR + 6), headerH,
          theme::bg, FONT_LABEL, c, MR_DATUM, String(label));

  _tft.fillRect(dotCx - dotR, cy - dotR, 2 * dotR + 1, 2 * dotR + 1, theme::bg);
  _tft.fillCircle(dotCx, cy, dotR, c);
}

// ---------------------------------------------------------------------------
//  Cards
// ---------------------------------------------------------------------------

// "62.0%   +2.1% / h", or the same with "--" where two polls have not yet
// produced a rate. Both card types put this at the right of a track's caption
// row, so the formatting lives in one place.
static String rateReadout(float pct, bool haveRate, float rate) {
  String s = String(pct, 1);
  s += F("%   ");
  s += haveRate ? formatRate(rate) : String(F("--"));
  return s;
}

// The faction insignia alone, on a dark disc, top-right of the art band.
//
// There is no label: the badge's text lived in a row this design no longer
// has, and the three marks are distinct enough to carry it. SEAF has no
// insignia that survives reduction to this size (see factionIcon), so a
// human-held planet simply shows no mark rather than a blob.
void HUDRenderer::drawFactionMark(const String &faction) {
  const ColorIconRef ic = factionIcon(faction);
  if (!ic.px) return;

  const int16_t r = ic.w / 2 + markPad;
  const int16_t cx = cardX + cardW - markInset - r;
  const int16_t cy = artY + markInset + r;

  _tft.fillCircle(cx, cy, r, theme::bg);
  _tft.drawCircle(cx, cy, r, theme::cardEdge);
  // The icon arrays are plain uint16_t, so on a little-endian ESP32 they reach
  // the panel byte-reversed unless this is set -- which turns the Automaton's
  // salmon into a pale blue.
  _tft.setSwapBytes(true);
  _tft.pushImage(cx - ic.w / 2, cy - ic.h / 2, ic.w, ic.h, ic.px,
                 facicons::kTransparent);
  _tft.setSwapBytes(false);
}

// The art band: the biome plate with the planet's identity set over it. Both
// card types open with this, which is what makes the carousel hold still as
// it advances -- only the headline stat and what sits below the band differ.
void HUDRenderer::drawArtBand(const PlanetInfo &p, int16_t h, const String &headline,
                              uint16_t headlineColor, const String &orderTitle,
                              const String &fallbackName) {
  const int8_t bi = biomeFromName(p.biome);
  const uint16_t *plate =
      (uint16_t *)pgm_read_ptr(&biomes::table[bi < 0 || bi >= biomes::kCount
                                                  ? kBiomeUnknown
                                                  : bi]);
  drawBiome(plate, biomes::kW, biomes::kH, cardX, artY, cardW, h, artScrimW,
            artScrimMax);
  _tft.drawRect(cardX, artY, cardW, h, theme::cardEdge);

  const int16_t tx = cardX + artPad;
  // Everything left of the faction mark's disc is the identity's to use.
  const int16_t availW =
      cardW - artPad - markInset - (facicons::automatonW + 2 * markPad) - 12;

  // Anton is condensed, but planet names run to "ANGEL'S VENTURE"; drop a cut
  // and then trim rather than run under the mark.
  String name = upper(p.valid ? p.name
                              : (fallbackName.length() ? fallbackName
                                                       : String(F("UNKNOWN"))));
  const GFXfont *nameFont = FONT_HEADLINE;
  _tft.setFreeFont(nameFont);
  if (_tft.textWidth(name.c_str()) > availW) {
    nameFont = FONT_HEADLINE_SM;
    _tft.setFreeFont(nameFont);
  }
  while (name.length() > 1 && _tft.textWidth(name.c_str()) > availW) {
    name.remove(name.length() - 1);
  }
  drawOverText(tx, artY + artNameDy, artNameH, nameFont, theme::text, name);

  const String sector = sectorLabel(p.sector);
  if (sector.length()) {
    drawOverText(tx, artY + artSectorDy, artSectorH, FONT_BODY, theme::grey, sector);
  }
  if (headline.length()) {
    drawOverText(tx, artY + artStatDy, artStatH, FONT_VALUE, headlineColor, headline);
  }

  // The order's own name, under the headline. Trimmed against the clock
  // plate's left edge so a long title stops rather than running under it.
  if (orderTitle.length()) {
    String shown = orderTitle;
    const int16_t stopAt = cardX + cardW - plateInset - plateW - 10;
    _tft.setFreeFont(FONT_LABEL);
    while (shown.length() > 1 && tx + _tft.textWidth(shown.c_str()) > stopAt) {
      shown.remove(shown.length() - 1);
    }
    drawOverText(tx, artY + artTitleDy, artTitleH, FONT_LABEL, theme::gold, shown);
  }

  drawFactionMark(p.owner);
}

// The stat strip both cards close with: share of the galaxy's divers, the
// head-count here, the players' push, and the enemy's regen. The last two are
// the halves of the net rate the track above is moving at -- push minus regen
// -- which is why they sit together rather than beside their own bars.
//
// That pair only exists when the track above *is* a planet's own liberation or
// defence. A count-style objective is measured against the order's goal
// instead: nothing pushes the count but the war, and the planet's regen (when
// it even has a planet) is not what the bar is moving on. Both columns were
// therefore structurally "--" on every count card ever drawn -- not
// occasionally, always -- so `eta` replaces them with the one forward-looking
// figure that payload does support, and the row closes at three columns.
//
// The band is cleared as a unit first because the column count is no longer
// fixed: a carousel step from a liberation target to a count one repaints the
// card without repainting the screen, and four columns' worth of separators
// and captions would otherwise show through three columns' worth of paint.
void HUDRenderer::drawStrip(const HudModel &m, const PlanetInfo &p, bool haveRate,
                            float rate, uint16_t accent, const String &eta,
                            bool countStyle) {
  const float regenPctPerHour =
      p.maxHealth > 0 ? p.regenPerSecond * 3600.0f * 100.0f / (float)p.maxHealth : 0.0f;
  const float pushPctPerHour = (haveRate ? rate : 0.0f) + regenPctPerHour;

  char share[12], here[16], push[16], regen[16];
  // Galaxy-wide count is a separate reading taken at a separate moment, so it
  // can legitimately be smaller than this planet's. Clamp rather than print an
  // arithmetically-correct 200050%.
  const uint32_t galaxy = m.war.valid ? m.war.playerCount : 0;
  uint32_t sharePct = galaxy ? (uint32_t)((p.playerCount * 100ULL) / galaxy) : 0U;
  if (sharePct > 100) sharePct = 100;
  // Every column here is read off the planet record, so without one they are
  // all unknown rather than zero — and a count-style card is drawn from the
  // assignment payload alone, which makes "no planet, real progress" a routine
  // state rather than a broken one. "0 DIVERS / 0.00% REGEN" under a bar that
  // is visibly moving reads as a contradiction; "--" is what the PUSH column
  // has always said when it had nothing to report, so say it four times over.
  if (p.valid) {
    snprintf(share, sizeof(share), "%u%%", (unsigned)sharePct);
    snprintf(here, sizeof(here), "%s", formatCount(p.playerCount).c_str());
    if (haveRate) snprintf(push, sizeof(push), "%.3f%%", pushPctPerHour);
    else          snprintf(push, sizeof(push), "--");
    snprintf(regen, sizeof(regen), "%.2f%%", regenPctPerHour);
  } else {
    snprintf(share, sizeof(share), "--");
    snprintf(here, sizeof(here), "--");
    snprintf(push, sizeof(push), "--");
    snprintf(regen, sizeof(regen), "--");
  }

  // "/H" on the two rates because they are per-hour and the values carry only
  // a percent sign; without it "2.593%" reads as a position, not a speed.
  struct Col { const char *cap; String v; uint16_t c; };
  Col cols[stripCols];
  uint8_t n = 0;
  cols[n++] = {"SHARE", share, theme::gold};
  cols[n++] = {"DIVERS", here, theme::text};
  if (countStyle) {
    cols[n++] = {"ETA", eta.length() ? eta : String(F("--")), theme::blue};
  } else {
    cols[n++] = {"PUSH /H", push, theme::blue};
    cols[n++] = {"REGEN /H", regen, accent};
  }

  const int16_t stripH = (stripValY + stripValH) - stripCapY;
  _tft.fillRect(padX, stripCapY, contentW, stripH, theme::bg);

  const int16_t colW = contentW / n;
  for (uint8_t i = 0; i < n; i++) {
    const int16_t x = padX + i * colW;
    // nullptr font == TFT_eSPI's built-in 6x8 GLCD face; see setFreeFont().
    textBox(x, stripCapY, colW - 6, stripCapH, theme::bg, nullptr, theme::grey,
            ML_DATUM, cols[i].cap);
    textBox(x, stripValY, colW - 6, stripValH, theme::bg, FONT_LABEL, cols[i].c,
            ML_DATUM, cols[i].v);
    if (i) _tft.drawFastVLine(x - 4, stripCapY + 2, stripH - 4, theme::cardEdge);
  }
}

void HUDRenderer::drawCard(const HudModel &m) {
  _targetSig = targetSignature(m, _pageIdx);

  const OrderTask *t = activeTask(m, _pageIdx);
  if (!t) {
    _tft.fillRect(cardX, artY, cardW, (stripValY + stripValH) - artY, theme::bg);
    textBox(cardX, artY + 50, cardW, 34, theme::bg, FONT_VALUE, theme::grey, MC_DATUM,
            F("ORDER HAS NO TARGETS"));
    _clockSig = "";
    return;
  }

  const PlanetInfo &p = t->planet;
  // Whoever is attacking sets the card's accent; with nobody attacking it
  // falls back to the HUD's own gold.
  const uint16_t accent =
      p.event.active ? factionAccent(p.event.faction) : theme::gold;
  const CardRates r = cardRates(m, _pageIdx, *t);

  const CardRates cr = countRate(m, _pageIdx, *t);

  // The headline is whatever this objective is honestly measured by: a count
  // by how far through its own goal it is, a defence by how much of it is
  // held, a liberation by how much is taken, and anything else by the one
  // thing the API is unambiguous about.
  //
  // The count case is tested first, and without consulting the planet at all.
  // Its progress comes from the assignment payload, so it is the one figure
  // still available when /planets/{index} 404s — the state that used to leave
  // this card reading "UNKNOWN / OBJECTIVE COMPLETE / AWAITING TELEMETRY" for
  // an objective that was in fact a fifth of the way in. It also outranks a
  // defence running on the same planet: the order asks for the count, and
  // that is what the card is reporting against.
  String headline;
  uint16_t headlineColor = theme::gold;
  char buf[32];
  if (taskIsCount(*t)) {
    const StatusLine st = objectiveStatus(*t);
    headline = st.text;
    headlineColor = st.color;
  } else if (p.valid && p.event.active) {
    snprintf(buf, sizeof(buf), "%.0f%% DEFENDED", p.event.defended());
    headline = buf;
  } else if (p.valid && taskIsLiberation(t->taskType)) {
    snprintf(buf, sizeof(buf), "%.1f%% LIBERATED", p.liberation);
    headline = buf;
  } else {
    const StatusLine st = objectiveStatus(*t);
    headline = st.text;
    headlineColor = st.color;
  }

  // With no planet record there is still something true to put in the identity
  // line. Naming the index says which planet the API has no entry for, which
  // is a fact; "UNKNOWN" reads as a fault in the device. A count task with no
  // planet slot at all is genuinely galaxy-wide and says so.
  String fallbackName;
  if (!p.valid) {
    if (t->planetIndex >= 0) fallbackName = String(F("PLANET ")) + String(t->planetIndex);
    else if (taskIsCount(*t)) fallbackName = F("GALAXY-WIDE");
  }

  drawArtBand(p, artOrderH, headline, headlineColor, upper(m.order.title), fallbackName);

  // Cleared as one band whichever way it is about to be filled: a one-track
  // card following a two-track one would otherwise leave the second bar
  // stranded on screen, and the two layouts do not share row positions.
  _tft.fillRect(cardX, orderCap1Y, cardW, orderBandEnd - orderCap1Y, theme::bg);

  if (taskIsCount(*t)) {
    // The liberation bar's language, against the task's own goal instead of a
    // planet's health: caption names what is being counted and carries the
    // running total, readout gives the percentage and the rate it is moving
    // at. formatCompact keeps "241.2M / 1.3B" inside the caption's half-width
    // where the raw figures would run past it by a mile.
    //
    // Drawn from the assignment payload alone — no p.valid test anywhere in
    // here — because a planet lookup that fails must cost the card its
    // artwork and stat strip, not its progress.
    const CountWords w = countWords(t->taskType);
    const float pct = taskPercent(*t);
    String caption = String(w.track) + F("  ") + formatCompact(t->progress) +
                     F(" / ") + formatCompact(t->goal);
    drawBarRow(orderSoloCapY, orderSoloBarY, campBarH, caption,
               rateReadout(pct, cr.have, cr.pct),
               t->complete ? theme::green : theme::blue, pct,
               t->complete ? theme::green : theme::blue);
  } else if (p.valid && p.event.active) {
    // A defence is a tug of war over one bar: our share and theirs. The API
    // publishes only the pair, so the second bar is the first's complement —
    // and its rate is therefore the mirror of the first's, not a second
    // independent measurement.
    const float held = p.event.defended();
    drawBarRow(orderCap1Y, orderBar1Y, orderBarH, String(F("SEAF HOLDING")),
               rateReadout(held, r.have, r.pct), theme::blue, held, theme::blue);
    drawBarRow(orderCap2Y, orderBar2Y, orderBarH,
               upper(factionDisplayName(p.event.faction)) + String(F(" PUSH")),
               rateReadout(100.0f - held, r.have, -r.pct), accent, 100.0f - held,
               accent);
  } else if (p.valid && taskIsLiberation(t->taskType)) {
    drawBarRow(orderSoloCapY, orderSoloBarY, campBarH, String(F("LIBERATION")),
               rateReadout(p.liberation, r.have, r.pct), theme::blue, p.liberation,
               theme::blue);
  } else {
    // A defend objective with nothing attacking it has no progress to show:
    // the planet sits at full health, which is not "0% done". Now a genuine
    // last resort — every objective that carries a goal of its own is drawn as
    // a real bar above, so reaching here means the task offered no measurable
    // progress at all, not merely that it was an unfamiliar type.
    drawIdleTrack(orderSoloCapY, orderSoloBarY, campBarH,
                  p.valid ? String(F("NO ASSAULT IN PROGRESS"))
                          : String(F("AWAITING TELEMETRY")));
  }

  // A count objective's strip trades PUSH/REGEN for how long the goal is still
  // away at the rate the count is actually moving -- which is the question the
  // card is being asked, since the order's own clock is on the plate above it.
  // Measured off the same two samples the bar's %/h is, so it says "--" in the
  // same places that does rather than extrapolating from one poll.
  String eta;
  if (taskIsCount(*t)) {
    const float remain = 100.0f - taskPercent(*t);
    if (t->complete || remain <= 0.0f) {
      eta = F("MET");
    } else if (cr.have && cr.pct > 0.0f) {
      const double hours = (double)remain / cr.pct;
      // Past three months the figure stops being a forecast and starts being
      // arithmetic about a rate nobody expects to hold; say so rather than
      // print a date in the next war.
      eta = hours > 99.0 * 24.0 ? String(F("> 99d"))
                                : formatDuration((int64_t)(hours * 3600.0));
    }
  }

  drawStrip(m, p, r.have, r.pct, accent, eta, taskIsCount(*t));
  _clockSig = "";  // the plate went down with the art
}

// The order's clock and title, on their own filled plate at the foot of the
// art. The plate exists because the clock ticks: text painted straight onto
// the photograph could not be repainted without regenerating the artwork
// underneath it every second.
void HUDRenderer::drawCardClocks(const HudModel &m, time_t nowUtc) {
  if (!_cardMode) return;

  // 1.6e9 ~= 2020-09; anything below that means NTP hasn't synced yet and a
  // countdown would be nonsense.
  const bool clockOk = nowUtc > 1600000000;
  const OrderTask *t = activeTask(m, _pageIdx);

  // A running defence has its own deadline, and while one is up that is the
  // clock that matters; otherwise the order's own expiry is the only one
  // there is.
  String label = F("ORDER ENDS");
  int64_t until = (int64_t)m.order.expiration;
  if (t && t->planet.event.active && t->planet.event.endTime > 0) {
    label = F("VICTORY IN");
    until = (int64_t)t->planet.event.endTime;
  }
  const String clock = (until > 0 && clockOk)
                           ? formatDuration(until - (int64_t)nowUtc)
                           : String(F("--"));

  const String sig = label + "|" + clock;
  if (sig == _clockSig) return;
  _clockSig = sig;

  const int16_t plateH = plateLabelH + plateClockH + 2 * platePadY;
  const int16_t px = cardX + cardW - plateInset - plateW;
  const int16_t py = artY + artOrderH - plateInset - plateH;

  _tft.fillRect(px, py, plateW, plateH, theme::bg);
  _tft.drawRect(px, py, plateW, plateH, theme::cardEdge);

  // nullptr font == the built-in 6x8 GLCD face; the label is a caption, and
  // setting it any larger is what made the one-line form too wide to fit.
  textBox(px + 1, py + platePadY, plateW - 2, plateLabelH, theme::bg, nullptr,
          theme::grey, MC_DATUM, label);
  textBox(px + 1, py + platePadY + plateLabelH, plateW - 2, plateClockH, theme::bg,
          FONT_LABEL, theme::text, MC_DATUM, clock);
}

// ---------------------------------------------------------------------------
//  Body
// ---------------------------------------------------------------------------

void HUDRenderer::drawBody(const HudModel &m, time_t nowUtc) {
  // Clear the whole frame interior, then repaint the frame, since the corner
  // brackets are thicker than the 1px border we left standing.
  _tft.fillRect(frameX + 1, frameY + 1, frameW - 2, frameH - 2, theme::bg);
  drawFrame();

  _cardMode = pageIsCard(m, _pageIdx);
  const bool onCampaign = !_cardMode && pageCount(m) > 0;

  // Every screen wears the same header row now: what it is showing, the
  // LIBCON reading, and where in the carousel it sits. Forced through rather
  // than left to its signature: the row was just cleared with the rest of the
  // frame, whatever it happens to say next.
  _headerSig = "";
  drawHeader(m);
  _wifiSig = -1;  // the repaint wiped the dot

  if (!m.haveData) {
    _tft.drawBitmap(padX + (contentW - icons::emblemLargeW) / 2, 96,
                    icons::emblemLarge, icons::emblemLargeW, icons::emblemLargeH,
                    theme::goldDim);
    textBox(padX, 150, contentW, 34, theme::bg, FONT_DISPLAY, theme::gold, MC_DATUM,
            F("ESTABLISHING UPLINK"));
    drawRule(rule3Y);
  } else if (_cardMode) {
    _targetSig = "";
    drawCard(m);
  } else if (onCampaign) {
    // Campaign pages only exist when no order is active, so the page index is
    // the campaign index directly -- there are no card pages ahead of them.
    _campaignSig = "";
    const uint8_t ci = _pageIdx;
    drawCampaignBody(m, m.campaigns[ci], m.campaignHistory[ci]);
  } else {
    drawIdleBody(m);
    drawRule(rule3Y);
  }

  // Force the self-updating regions to repaint into the freshly cleared area.
  _clockSig = "";
  _footerSig = "";
  if (_cardMode) drawCardClocks(m, nowUtc);
  drawFooter(m, nowUtc);
}

void HUDRenderer::drawCampaignBody(const HudModel &m, const PlanetInfo &p,
                                   const RateSample &h) {
  const uint16_t accent = factionAccent(p.owner);

  float rate = 0.0f;
  const bool haveRate =
      h.valid && ratePerHour(p.liberation, p.observedAt, h.libPct, h.at, rate);

  // Four decimals because a campaign moves slowly enough that fewer would sit
  // unchanged between polls and read as a frozen screen.
  char headline[32];
  snprintf(headline, sizeof(headline), "%.4f%% LIBERATED", p.liberation);
  drawArtBand(p, artCampH, headline, theme::gold);

  drawBarRow(campCapY, campBarY, campBarH, String(F("LIBERATION")),
             rateReadout(p.liberation, haveRate, rate), accent, p.liberation, accent);

  drawStrip(m, p, haveRate, rate, accent);
}

void HUDRenderer::drawIdleBody(const HudModel &m) {
  // With no order to show, the emblem becomes the centrepiece and the galactic
  // war totals take over the tiles.
  _tft.drawBitmap(padX + (contentW - icons::emblemLargeW) / 2, 92, icons::emblemLarge,
                  icons::emblemLargeW, icons::emblemLargeH, theme::goldDim);
  // At 18pt this line is 463px, wider than the 440px content column, so it is
  // set at value size.
  textBox(padX, 146, contentW, 28, theme::bg, FONT_VALUE, theme::gold, MC_DATUM,
          F("NO ACTIVE MAJOR ORDER"));

  drawTile(0, icons::divers, icons::diversW, icons::diversH,
           m.war.valid ? formatCompact(m.war.playerCount) : String("--"), theme::gold);
  drawTile(1, icons::skull, icons::skullW, icons::skullH,
           m.war.valid ? formatCompact(m.war.totalKills) : String("--"), theme::gold);
  drawTile(2, icons::check, icons::checkW, icons::checkH,
           m.war.valid ? String(m.war.missionSuccessRate) + "%" : String("--"),
           theme::gold);
}

// A clock face at caption scale: a ring with an hour and a minute hand. Small
// enough to sit inside the footer row beside a 6x8 time, and drawn from
// primitives rather than added to hud_icons.h -- the existing clock bitmap is
// 24px, three times this row's budget, and the image is at 96% of its flash
// slot. The hands are drawn as plain runs because at r=5 an angled line is
// three pixels of noise; up and right reads as "a clock" and nothing else.
static void drawClockGlyph(TFT_eSPI &tft, int16_t cx, int16_t cy, uint16_t c) {
  tft.drawCircle(cx, cy, syncGlyphR, c);
  tft.drawFastVLine(cx, cy - 3, 4, c);
  tft.drawFastHLine(cx, cy, 3, c);
}

// The footer row: the order's reward at the left, the sync clock at the right.
//
// It used to open with the head-count on the planet being shown, which was the
// same number the strip's DIVERS column had already given a caption to two
// rows above -- one planet's divers, printed twice on one screen. The strip is
// where it belongs (it sits beside SHARE, which is that count over the
// galaxy's), so this row lost it.
//
// What is left is deliberately not repacked to fill the width. The reward is
// the row's one headline and takes the left edge and FONT_VALUE for it; the
// sync time is a staleness indicator, not a reading anyone comes to the panel
// for, so it shrank to a glyph and a 6x8 HH:MM at the right. The space between
// them stays empty on purpose: everything else this row could carry is either
// already on the card or would be filler.
void HUDRenderer::drawFooter(const HudModel &m, time_t nowUtc) {
  String synced;
  if (!m.haveData) {
    synced = F("NO DATA");
  } else {
    char t[8] = "--:--";
    if (m.lastSuccess > 0) {
      // Shift the epoch, then read it back as if it were UTC: that yields
      // local wall-clock time without depending on a TZ database being
      // present, and without touching the countdowns, which are durations.
      struct tm tmv;
      time_t ls = m.lastSuccess + (time_t)m.utcOffsetMin * 60;
      gmtime_r(&ls, &tmv);
      snprintf(t, sizeof(t), "%02d:%02d", tmv.tm_hour, tmv.tm_min);
    }
    // "SYNCED" is gone: the word cost the row 150px of body text to qualify a
    // clock reading that is only interesting when it is old. "STALE" stays,
    // because that is the case where the number above it cannot be trusted and
    // the row has one line in which to say so — at caption size it costs 36px,
    // not 150, and colour alone at 6x8 is a thin thing to hang it on.
    synced = m.stale ? String(F("STALE ")) + t : String(t);
  }

  // Reward, as a medal icon and a bare number — "REWARD n MEDALS" spelled out
  // was the single wordiest thing on the HUD for one integer of information.
  String reward;
  if (m.haveData && m.order.valid && m.order.rewardAmount > 0) {
    reward = String(m.order.rewardAmount);
  }

  const String sig = synced + "|" + reward + "|" + (m.stale ? "1" : "0") + "|" +
                     (m.touchUncalibrated ? "1" : "0");
  if (sig == _footerSig) return;
  _footerSig = sig;

  const int16_t y = footerY;
  const int16_t h = footerH;
  // Amber rather than the goldMute this line used to fade to. Muting was
  // legible while it was 150px of body text; shrunk to a 6x8 caption it made
  // the one state worth noticing the hardest thing on the panel to read, which
  // is backwards. Stale data is a caution, so it takes the caution colour.
  const uint16_t syncColor = m.stale ? theme::amber : theme::grey;

  // --- left: the order's reward -------------------------------------------
  // Cleared to a fixed width rather than the number's own: an order paying 45
  // following one that paid 120 would otherwise leave the hundreds digit
  // standing. The box holds four digits, well past any reward issued so far.
  const int16_t rewardW = icons::medalW + footerIconGap + kRewardBoxW;
  textBox(cardX, y, rewardW, h, theme::bg, FONT_VALUE, theme::gold, ML_DATUM,
          reward, icons::medalW + footerIconGap);
  if (reward.length()) {
    _tft.drawBitmap(cardX, y + (h - icons::medalH) / 2, icons::medal, icons::medalW,
                    icons::medalH, theme::gold);
  }

  // --- middle: the uncalibrated-touch hint ---------------------------------
  // Painted unconditionally, with an empty string when there is nothing to say,
  // so the frame calibration succeeds on is the frame the line disappears in --
  // the box clears itself and, because calibrated() never goes back to false on
  // its own, never comes back. theme::grey and the 6x8 face: the same weight as
  // the sync time across from it, which is the right of way for a caption that
  // is only addressed to a unit nobody has set up yet. Deliberately not
  // goldMute -- gold at this size is what the reward beside it is using, and
  // muted gold on this background was already found to be the least legible
  // thing on the panel when the footer was reworked.
  const String hint =
      m.touchUncalibrated ? String(F("HOLD SCREEN AT POWER-ON TO CALIBRATE")) : String();
  textBox(kHintX, y, kHintW, h, theme::bg, nullptr, theme::grey, MC_DATUM, hint);

  // --- right: last sync ----------------------------------------------------
  // The link state moved to the header row with the LIBCON chip, so this row
  // is the sync line's alone and it can run to the content edge.
  textBox(contentR - syncBoxW, y, syncBoxW, h, theme::bg, nullptr, syncColor,
          MR_DATUM, synced);
  // nullptr font == the built-in 6x8 GLCD face, the same one the box above was
  // set in; the glyph rides just left of whatever width that came to, and sits
  // inside the box's own clear so the previous frame's copy goes with it.
  _tft.setFreeFont(nullptr);
  const int16_t timeW = _tft.textWidth(synced.c_str());
  drawClockGlyph(_tft, contentR - timeW - syncGap - syncGlyphR, y + h / 2, syncColor);

  (void)nowUtc;
}

// ---------------------------------------------------------------------------
//  Public entry points
// ---------------------------------------------------------------------------

void HUDRenderer::updateCarousel(const HudModel &m) {
  const uint8_t count = pageCount(m);
  if (count <= 1) {
    // Nothing to cycle. Keep the stamp fresh so the first multi-page state to
    // arrive gets a full dwell before it advances.
    _pageIdx = 0;
    _pageSwitchMs = millis();
    return;
  }
  if (_pageIdx >= count) _pageIdx = 0;  // data set shrank under us

  const uint32_t nowMs = millis();
  if ((uint32_t)(nowMs - _pageSwitchMs) >= kCarouselCycleMs) {
    _pageIdx = (uint8_t)((_pageIdx + 1) % count);
    _pageSwitchMs = nowMs;
  }
}

void HUDRenderer::advancePage(const HudModel &m, int8_t delta) {
  const uint8_t count = pageCount(m);
  if (count == 0) return;

  // Wrap in both directions. `delta` is +/-1 from a swipe, but the modulo is
  // written to survive any value rather than assuming that.
  int16_t next = (int16_t)_pageIdx + delta;
  while (next < 0) next += count;
  _pageIdx = (uint8_t)(next % count);

  // Restarting the dwell is the whole point of doing this here rather than
  // poking _pageIdx from outside: a manual advance that still expired on the
  // old schedule would page again a moment later, undoing the thing that was
  // just asked for. Cody's explicit decision is that the timer stays as a
  // fallback -- so it keeps running, it just starts counting again from now.
  _pageSwitchMs = millis();
}

void HUDRenderer::resetCarousel() {
  _pageIdx = 0;
  _pageSwitchMs = millis();
}

// ---------------------------------------------------------------------------
//  Event overlays
// ---------------------------------------------------------------------------

// Greedy word wrap into `out`, at most `maxLines` lines of `maxW` pixels in
// whatever font is currently selected. Returns how many lines were used.
//
// A word longer than the line is hard-broken rather than dropped: order titles
// are written by a game studio, not by this renderer, and one unbroken
// 40-character string should not blank a screen. The last line is ellipsed if
// there is more text than room, so a truncated briefing looks truncated rather
// than finished.
int8_t HUDRenderer::wrapText(const String &s, int16_t maxW, int8_t maxLines,
                             String *out) {
  int8_t used = 0;
  int idx = 0;
  const int len = s.length();

  while (idx < len && used < maxLines) {
    while (idx < len && s[idx] == ' ') idx++;  // eat run-on spaces
    if (idx >= len) break;

    int fit = idx;      // one past the last character known to fit
    int lastSpace = -1; // last space seen inside that run
    while (fit < len) {
      if (s[fit] == '\n') break;
      const String probe = s.substring(idx, fit + 1);
      if (_tft.textWidth(probe.c_str()) > maxW) break;
      if (s[fit] == ' ') lastSpace = fit;
      fit++;
    }

    int end = fit;
    if (fit < len && s[fit] != '\n' && lastSpace > idx) end = lastSpace;
    if (end <= idx) end = idx + 1;  // hard break: nothing fit, take one char

    out[used] = s.substring(idx, end);
    out[used].trim();
    used++;
    idx = end;
    if (idx < len && s[idx] == '\n') idx++;
  }

  // Anything left over is signalled on the final line rather than silently
  // dropped.
  if (idx < len && used > 0) {
    String &tail = out[used - 1];
    while (tail.length() > 1 &&
           _tft.textWidth((tail + "...").c_str()) > maxW)
      tail.remove(tail.length() - 1);
    tail += "...";
  }
  return used;
}

// ---------------------------------------------------------------------------
//  The three Major Order overlays
//
//  One composition, three screens -- see the ovl* block in config.h for the
//  geometry, the proportions it was traced at, and what the references have
//  that this does not.
// ---------------------------------------------------------------------------

namespace {

// How the one stored art plate is pushed around to stand in for the three
// photographs the references use. Integer throughout: this runs once per pixel
// of a 240x320 plate, on a core with nothing better to do but no FPU worth
// using either.
//
//   desat     0-255, how far toward luminance a pixel is dragged
//   rGain..   per-channel gain in 128ths, so 128 is unity
//   lift      added to every channel afterwards, signed
//   emberH    rows off the bottom of the plate carrying the fire glow
//   emberMax  how strong that glow is at the very bottom row
struct ArtGrade {
  int16_t desat;
  int16_t rGain, gGain, bGain;
  int16_t lift;
  int16_t emberH, emberMax;
};

// The announcement is the plate as photographed. The other two were set by
// sampling the reference banners against the same regions of this plate
// rather than by eye. Means, source -> reference target:
//
//   * success. Sky (27,40,78) -> (67,85,123), flag (38,48,79) -> (87,98,126).
//     Almost all of that is a flat lift, not a blue push: the reference is
//     the same night, exposed up. An earlier pass read it as "cooler" and
//     gained the blue hard, which came out as a cast rather than as light.
//   * failure. Sky (27,40,78) -> (39,36,38), flag (38,48,79) -> (60,56,58).
//     Not the red wash it looks like from across a room -- a heavy desaturate
//     with a warm bias, held a touch under the source exposure, with the
//     fires doing all the colouring. Which is also why the flag needs no
//     protecting: the reference lets the smoke take its navy too. The grade
//     is set on the flag, the subject; that leaves the sky ~5 light, and no
//     single global grade can have both.
constexpr ArtGrade kGradeNew     = {  0, 128, 128, 128,  0,   0,   0};
constexpr ArtGrade kGradeSuccess = {  0, 122, 130, 134, 40,   0,   0};
constexpr ArtGrade kGradeFailure = {175, 142, 119, 105,  2, 110, 140};

// What the failure's ember ramp blends toward: a sodium fire rather than a
// clean red, so it reads as a city burning and not as a filter over one.
constexpr uint16_t kEmber = rgb565(0xB4, 0x40, 0x12);

inline uint8_t clamp8(int v) { return v < 0 ? 0 : (v > 255 ? 255 : (uint8_t)v); }

uint16_t gradePixel(uint16_t px, const ArtGrade &g) {
  const int r0 = ((px >> 11) & 0x1F) << 3;
  const int g0 = ((px >> 5) & 0x3F) << 2;
  const int b0 = (px & 0x1F) << 3;

  int r = r0, gg = g0, b = b0;
  if (g.desat) {
    const int y = (r0 * 77 + g0 * 151 + b0 * 28) >> 8;
    r += ((y - r) * g.desat) >> 8;
    gg += ((y - gg) * g.desat) >> 8;
    b += ((y - b) * g.desat) >> 8;
  }
  r = (r * g.rGain) >> 7;
  gg = (gg * g.gGain) >> 7;
  b = (b * g.bGain) >> 7;
  return rgb565(clamp8(r + g.lift), clamp8(gg + g.lift), clamp8(b + g.lift));
}

}  // namespace

// The panel's angled right edge, and the right edge of the text column, at row
// `y`. The column is a trapezoid: every row of type has to wrap to its own
// width, and every plate drawn in it has to take the narrowest row it spans.
int16_t HUDRenderer::overlayEdgeX(int16_t y) {
  if (y < 0) y = 0;
  if (y > screenH) y = screenH;
  return (int16_t)(ovlEdgeTop + ((int32_t)(ovlEdgeBot - ovlEdgeTop) * y) / screenH);
}

int16_t HUDRenderer::overlayTextR(int16_t y) { return overlayEdgeX(y) - ovlTextPadR; }

// The photograph down the right: hud_mo_art.h at half resolution, scaled 2x
// through the same srcCoord()/lerp565() pair drawBiome() uses, and graded on
// the way past. One plate for three screens because three would not fit the
// app slot -- tools/gen_mo_art.py carries that arithmetic.
//
// Graded here, inside the scaler, rather than as a second pass over the panel:
// the pixel is already computed and in a register, and a second pass would
// mean reading 240x320 back off a display this talks to over SPI in one
// direction only.
void HUDRenderer::drawOverlayArt(OverlayKind kind) {
  const ArtGrade &g = kind == kOverlaySuccess   ? kGradeSuccess
                      : kind == kOverlayFailure ? kGradeFailure
                                                : kGradeNew;

  // pushImage() streams the buffer straight at the panel, which wants each
  // pixel MSB first; the words below are native-endian.
  const bool swap = _tft.getSwapBytes();
  _tft.setSwapBytes(true);

  uint16_t line[ovlArtW];
  for (int16_t j = 0; j < screenH; ++j) {
    const int32_t fy = srcCoord(j, moart::kH, screenH);
    const int32_t y0 = fy >> 8;
    const int32_t y1 = (y0 + 1 < moart::kH) ? y0 + 1 : y0;
    const int ty = fy & 0xFF;
    const uint16_t *r0 = &moart::flag[y0 * moart::kW];
    const uint16_t *r1 = &moart::flag[y1 * moart::kW];

    // A squared ramp off the bottom row, not a linear one: linear over 120
    // rows reads as a red gradient across the whole lower half, where the
    // reference's fire is a hot line at the skyline that falls away fast.
    int ember = 0;
    if (g.emberH > 0 && j >= screenH - g.emberH) {
      const int32_t u = j - (screenH - g.emberH);
      ember = (int)((u * u * g.emberMax) / ((int32_t)g.emberH * g.emberH));
    }

    for (int16_t i = 0; i < ovlArtW; ++i) {
      const int32_t fx = srcCoord(i, moart::kW, ovlArtW);
      const int32_t x0 = fx >> 8;
      const int32_t x1 = (x0 + 1 < moart::kW) ? x0 + 1 : x0;
      const int tx = fx & 0xFF;
      uint16_t px =
          lerp565(lerp565(pgm_read_word(&r0[x0]), pgm_read_word(&r0[x1]), tx),
                  lerp565(pgm_read_word(&r1[x0]), pgm_read_word(&r1[x1]), tx),
                  ty);
      px = gradePixel(px, g);
      if (ember) px = lerp565(px, kEmber, ember);
      line[i] = px;
    }
    _tft.pushImage(ovlArtX, j, ovlArtW, 1, line);
  }

  _tft.setSwapBytes(swap);
}

// Shreds bitten out of the flag's fly edge and slits torn through its body.
// A grade cannot tear cloth, and the failure reference's flag is in rags --
// which is most of what makes that screen read as a defeat before a word of
// it has been.
//
// The coordinates are plate-local, in the 240x320 the art is drawn at, and
// were measured off the plate rather than guessed. Scanning each row right to
// left for a run of navy puts the cloth's right edge at the plate boundary
// for every row from y 20 to y 216, with the emblem centred near (135,120) at
// a radius of 40 and the city starting below y 216. So the bites can all be
// anchored at x 240, the slits stay outboard of x 180, and nothing reaches
// the skyline -- an earlier table ran a bite down to y 220 and it landed on
// the horizon glow, a black wedge sitting in mid-air below the cloth.
//
// The profile is the part that took the tries. Bites of a similar span and
// depth, however unevenly spaced, come out as an even sawtooth -- a pinked
// edge, not cloth that has been shot at. What reads is variation in all
// three of span, depth and where the apex sits within the bite: a 9px nick
// next to a 54px tear, some apexes high in their bite and some low.
void HUDRenderer::drawFlagTears() {
  // top y, apex x, apex y, bottom y -- all anchored on the plate's right edge.
  static const int16_t kShred[][4] = {
      { 62, 226,  70,  78},
      { 96, 180, 122, 136},
      {146, 232, 150, 154},
      {166, 204, 172, 190},
  };
  for (uint8_t i = 0; i < sizeof(kShred) / sizeof(kShred[0]); ++i)
    _tft.fillTriangle(ovlArtX + 240, kShred[i][0], ovlArtX + kShred[i][1],
                      kShred[i][2], ovlArtX + 240, kShred[i][3], theme::smoke);

  // Punctures away from the edge. Angular rather than round: the first pass
  // used circles and they read as dead pixels, not as damage.
  static const int16_t kSlit[][6] = {
      {206,  84, 226,  80, 224,  90},
      {192, 146, 214, 142, 210, 152},
      {198, 178, 216, 175, 214, 184},
  };
  for (uint8_t i = 0; i < sizeof(kSlit) / sizeof(kSlit[0]); ++i)
    _tft.fillTriangle(ovlArtX + kSlit[i][0], kSlit[i][1], ovlArtX + kSlit[i][2],
                      kSlit[i][3], ovlArtX + kSlit[i][4], kSlit[i][5],
                      theme::smoke);

  // The hem, which is where this actually reads. The fly edge runs off the
  // right of the plate, so damage to it can only ever be notches in the
  // screen border; the bottom edge is a clean curve from (102,185) to
  // (234,217) silhouetted against the horizon glow, fully inside the frame.
  // Bites up into it, then tatters hanging off it in the graded cloth colour
  // -- the plate is already down and graded by the time this runs, so a rag
  // has to be painted the navy the grade left, not the navy of the source.
  constexpr uint16_t kRag = rgb565(0x34, 0x2F, 0x31);
  static const int16_t kHemBite[][6] = {
      {126, 193, 144, 198, 132, 182},
      {200, 211, 218, 215, 210, 199},
  };
  for (uint8_t i = 0; i < sizeof(kHemBite) / sizeof(kHemBite[0]); ++i)
    _tft.fillTriangle(ovlArtX + kHemBite[i][0], kHemBite[i][1],
                      ovlArtX + kHemBite[i][2], kHemBite[i][3],
                      ovlArtX + kHemBite[i][4], kHemBite[i][5], theme::smoke);

  static const int16_t kTatter[][6] = {
      {104, 186, 116, 191, 106, 205},
      {150, 199, 158, 201, 162, 212},
      {186, 207, 202, 211, 190, 232},
      {222, 215, 232, 217, 236, 224},
  };
  for (uint8_t i = 0; i < sizeof(kTatter) / sizeof(kTatter[0]); ++i)
    _tft.fillTriangle(ovlArtX + kTatter[i][0], kTatter[i][1],
                      ovlArtX + kTatter[i][2], kTatter[i][3],
                      ovlArtX + kTatter[i][4], kTatter[i][5], kRag);
}

// The text panel, the angled edge, the accent hairline riding it, and the
// border around the screen.
//
// Row by row rather than a fill plus a triangle: the edge is a slant, this
// build's TFT_eSPI shim has no drawLine(), and the runs the fill is made of
// anyway are exactly what a slant needs. The art is already down when this is
// called, so the rows over it paint it back out to the divider.
void HUDRenderer::drawOverlayPanel(uint16_t accent, uint16_t dim) {
  for (int16_t y = 0; y < screenH; ++y) {
    const int16_t e = overlayEdgeX(y);
    _tft.drawFastHLine(0, y, e, theme::bg);
    _tft.drawFastHLine(e, y, ovlEdgeInk, accent);
  }
  _tft.drawRect(0, 0, screenW, screenH, dim);
}

// Three stacked bars tapering away from whatever they flank, `dir` +1 for a
// mark to the right of `x` and -1 for one to its left. The motif the
// calibration band already carries; both references repeat it on every rule.
void HUDRenderer::drawWingBars(int16_t x, int16_t y, int16_t len, int8_t dir,
                               uint16_t c) {
  const int16_t bar[3] = {(int16_t)(len * 3 / 5), len, (int16_t)(len * 3 / 5)};
  for (uint8_t i = 0; i < 3; ++i) {
    const int16_t w = bar[i];
    _tft.fillRect(dir > 0 ? x : x - w, y - 3 + i * 3, w, 2, c);
  }
}

// The header row all three share: the badge at the left margin, the title
// beside it in Anton, and a rule under both that runs level and then kicks up
// to meet the divider -- the reference's tail, which is what makes the header
// read as a tab rather than as a line stopped short of the edge.
void HUDRenderer::drawOverlayHeader(OverlayKind kind, uint16_t accent,
                                    const String &title) {
  // Only the announcement's badge is winged, and the wings sit outside the
  // disc, so they push both the badge and the title along.
  const bool wings = (kind == kOverlayNewOrder);
  const int16_t badgeX = ovlPadX + (wings ? ovlWingW + ovlWingGap : 0);
  const int16_t cx = badgeX + ovlBadgeS / 2, cy = ovlHdrY + ovlBadgeS / 2;

  if (kind == kOverlayNewOrder) {
    // The winged globe: icons::globe inside a ring, flanked by the bar
    // flashes. Reusing the globe rather than cutting a new emblem asset --
    // it is 28px across, the ring's bore is 28px, and there are 28 KB of app
    // slot left over after the photograph.
    for (int8_t i = 0; i < 2; ++i) _tft.drawCircle(cx, cy, ovlBadgeS / 2 - i, accent);
    _tft.drawBitmap(cx - icons::globeW / 2, cy - icons::globeH / 2, icons::globe,
                    icons::globeW, icons::globeH, theme::text);
    drawWingBars(badgeX - ovlWingGap, cy, ovlWingW, -1, accent);
    drawWingBars(badgeX + ovlBadgeS + ovlWingGap, cy, ovlWingW, +1, accent);
  } else if (kind == kOverlaySuccess) {
    // The reference's victory mark: a brow arc over a broad chevron with a
    // smaller one beneath it. Both chevrons are a filled triangle with a
    // second knocked back out in the panel's own fill -- there is no stroked
    // polygon here, and at 34px a two-triangle outline is the shape anyway.
    drawArcRing(cx, cy + 1, 14, 16, 208.f, 332.f, accent);
    _tft.fillTriangle(cx - 15, cy - 4, cx + 15, cy - 4, cx, cy + 8, accent);
    _tft.fillTriangle(cx - 8, cy - 4, cx + 8, cy - 4, cx, cy + 2, theme::bg);
    _tft.fillTriangle(cx - 7, cy + 10, cx + 7, cy + 10, cx, cy + 17, accent);
    _tft.fillTriangle(cx - 3, cy + 10, cx + 3, cy + 10, cx, cy + 14, theme::bg);
  } else {
    // A disc with the cross knocked out of it, as the failure reference has.
    // Walked as overlapping squares rather than two quads: at this size a
    // quad's ends land on whichever side of a half-pixel the rounding picks
    // and the two arms come out different weights.
    _tft.fillCircle(cx, cy, ovlBadgeS / 2, accent);
    for (int16_t i = -8; i <= 8; ++i) {
      _tft.fillRect(cx + i - 2, cy + i - 2, 4, 4, theme::bg);
      _tft.fillRect(cx + i - 2, cy - i - 2, 4, 4, theme::bg);
    }
  }

  const int16_t titleX =
      badgeX + ovlBadgeS + (wings ? ovlWingGap + ovlWingW : 0) + ovlTitleGap;
  textBox(titleX, ovlHdrY, overlayTextR(cy) - titleX, ovlBadgeS, theme::bg,
          FONT_HEADLINE_SM, accent, ML_DATUM, title);

  const int16_t rEnd = overlayTextR(ovlRuleY);
  _tft.drawFastHLine(ovlPadX, ovlRuleY, rEnd - ovlRuleTail - ovlPadX, accent);
  for (int16_t i = 0; i < ovlRuleTail; ++i)
    _tft.drawFastHLine(rEnd - ovlRuleTail + i, ovlRuleY - i, 2, accent);
}

// One of the announcement's section rules: a centred ALL-CAPS word with a bar
// flash either side, measured off the string rather than pinned to the column
// so the marks sit against the word at any length.
void HUDRenderer::drawOverlayDivider(int16_t y, const String &label, uint16_t accent) {
  const int16_t cx = (ovlPadX + overlayTextR(y + ovlDivH)) / 2;
  const int16_t my = y + ovlDivH / 2;
  _tft.setFreeFont(FONT_LABEL);
  const int16_t half = _tft.textWidth(label.c_str()) / 2;
  textBox(cx - half - 2, y, 2 * half + 4, ovlDivH, theme::bg, FONT_LABEL, accent,
          MC_DATUM, label);
  drawWingBars(cx - half - 10, my, 18, -1, accent);
  drawWingBars(cx + half + 10, my, 18, +1, accent);
}

void HUDRenderer::drawOverlay(const HudModel &m, time_t nowUtc) {
  (void)nowUtc;
  // The bulletin is a different kind of thing wearing the same hat -- a
  // finished card rather than a layout to compose -- so it forks before any
  // of the shared geometry below, none of which it uses. Branching here and
  // not at the call site keeps "an overlay owns the panel" a single door in
  // update(), which is where the repaint-on-change bookkeeping lives.
  if (m.overlay == kOverlayBulletin) {
    drawBulletinOverlay();
    return;
  }

  const MajorOrder &o = m.overlaySubject;
  const bool verdict = (m.overlay == kOverlaySuccess || m.overlay == kOverlayFailure);

  // Three steps of one family, the way the calibration cards already branch:
  // the accent carries the type and the marks, the dim one the borders and
  // the hatch, the mute one the rows that are present but not the point.
  const uint16_t accent = m.overlay == kOverlaySuccess   ? theme::sage
                          : m.overlay == kOverlayFailure ? theme::brick
                                                         : theme::gold;
  const uint16_t dim = m.overlay == kOverlaySuccess   ? theme::sageDim
                       : m.overlay == kOverlayFailure ? theme::brickDim
                                                      : theme::goldDim;
  const uint16_t mute = m.overlay == kOverlaySuccess   ? theme::sageMute
                        : m.overlay == kOverlayFailure ? theme::brickMute
                                                       : theme::goldMute;

  // Art, then tears, then the panel over the top of both: the panel's angled
  // edge is what crops the photograph, so the photograph has to be down first.
  drawOverlayArt(m.overlay);
  if (m.overlay == kOverlayFailure) drawFlagTears();
  drawOverlayPanel(accent, dim);

  int done = 0;
  for (int i = 0; i < o.taskCount; ++i)
    if (o.tasks[i].complete) done++;

  if (!verdict) {
    // --- the announcement --------------------------------------------------
    // The caution stripe down the far left, as the announcement reference has
    // it; neither verdict does. Inset a pixel so it does not eat the border.
    drawHazardBar(1, 1, ovlStripeW, screenH - 2, dim);
    drawOverlayHeader(m.overlay, accent, "NEW MAJOR ORDER");

    // The briefing, in the reference's prose block and, like it, four lines.
    // Wrapped to the narrowest row it spans rather than to its own: the column
    // leans in on the way down, and a first line set to the width available at
    // its own height would overhang the divider by the time it is a fourth
    // line.
    const int16_t briefW = overlayTextR(ovlBriefY + ovlBriefMax * ovlBriefLead) - ovlPadX;
    String lines[ovlBriefMax];
    _tft.setFreeFont(FONT_BODY);
    const int8_t n = wrapText(o.briefing, briefW, ovlBriefMax, lines);
    int16_t y = ovlBriefY;
    for (int8_t i = 0; i < n; ++i) {
      textBox(ovlPadX, y, briefW, ovlBriefLead, theme::bg, FONT_BODY, theme::text,
              TL_DATUM, lines[i]);
      y += ovlBriefLead;
    }

    // --- the objective card ------------------------------------------------
    // The order's own title, which is the thing being announced -- the
    // reference has a placeholder progress row here because a marketing shot
    // has no order to name.
    drawOverlayDivider(ovlObjDivY, "OBJECTIVE", accent);
    const int16_t cardR = overlayTextR(ovlObjCardY + ovlObjCardH);
    _tft.fillRect(ovlPadX, ovlObjCardY, cardR - ovlPadX, ovlObjCardH, theme::panel);
    _tft.drawRect(ovlPadX, ovlObjCardY, cardR - ovlPadX, ovlObjCardH, dim);

    const int16_t inX = ovlPadX + 12, inW = cardR - 12 - inX;
    String tl[2];
    _tft.setFreeFont(FONT_LABEL);
    const int8_t tn = wrapText(upper(o.title.length() ? o.title : String("Major Order")),
                               inW, 2, tl);
    const int8_t rows = tn + (o.taskCount > 0 ? 1 : 0);
    int16_t ty = ovlObjCardY + (ovlObjCardH - rows * ovlObjLead) / 2;
    for (int8_t i = 0; i < tn; ++i) {
      textBox(inX, ty, inW, ovlObjLead, theme::panel, FONT_LABEL, accent, ML_DATUM, tl[i]);
      ty += ovlObjLead;
    }
    if (o.taskCount > 0) {
      char sub[40];
      snprintf(sub, sizeof(sub), "%d OBJECTIVE%s", (int)o.taskCount,
               o.taskCount == 1 ? "" : "S");
      textBox(inX, ty, inW, ovlObjLead, theme::panel, FONT_BODY, theme::grey,
              ML_DATUM, sub);
    }

    // --- the reward row ----------------------------------------------------
    drawOverlayDivider(ovlRwdDivY, "REWARD", accent);
    const int16_t rwdR = overlayTextR(ovlRwdRowY + ovlRwdRowH);
    _tft.fillRect(ovlPadX, ovlRwdRowY, rwdR - ovlPadX, ovlRwdRowH, theme::panel);
    _tft.drawRect(ovlPadX, ovlRwdRowY, rwdR - ovlPadX, ovlRwdRowH, dim);
    const int16_t mx = ovlPadX + 12, my = ovlRwdRowY + ovlRwdRowH / 2;
    _tft.drawBitmap(mx, my - icons::medalH / 2, icons::medal, icons::medalW,
                    icons::medalH, accent);
    // An order with no reward posted yet is the reference's own case, and it
    // says so rather than printing a zero. Kept short: the row sits low enough
    // that the slant has taken the column down to 171px.
    char rwd[48];
    if (o.rewardAmount > 0)
      snprintf(rwd, sizeof(rwd), "%d MEDALS", (int)o.rewardAmount);
    else
      snprintf(rwd, sizeof(rwd), "NOT YET POSTED");
    const int16_t rwdX = mx + icons::medalW + 10;
    textBox(rwdX, ovlRwdRowY + 1, rwdR - 1 - rwdX, ovlRwdRowH - 2, theme::panel,
            FONT_LABEL, theme::text, ML_DATUM, rwd);

    // --- the way out -------------------------------------------------------
    // Where the reference closes with its eagle and PREPARE. DEPLOY. COMPLETE.
    // The wording is this device's: the screen has taken the whole panel and
    // there is no other affordance on it, and touch is the only way out --
    // nothing clears this on a timer, so the line is the whole instruction.
    drawWingBars(ovlPadX + 16, ovlFootY + ovlFootH / 2, 16, -1, accent);
    const int16_t footX = ovlPadX + 26;
    textBox(footX, ovlFootY, overlayTextR(ovlFootY + ovlFootH) - footX, ovlFootH,
            theme::bg, FONT_LABEL, mute, ML_DATUM, "TOUCH TO DISMISS");
  } else {
    // --- the verdict -------------------------------------------------------
    drawOverlayHeader(m.overlay, accent,
                      m.overlay == kOverlaySuccess ? "MAJOR ORDER SUCCESSFUL"
                                                   : "MAJOR ORDER FAILED");

    // The prose block is the order's own title. The references carry three
    // lines of studio copy there; this has a real order to name, and naming it
    // is the difference between a verdict and a poster.
    const int16_t proseW = overlayTextR(ovlVerdProseY + 3 * ovlVerdLead) - ovlPadX;
    String pl[3];
    _tft.setFreeFont(FONT_BODY);
    const int8_t pn = wrapText(o.title.length() ? o.title : String("Major Order"),
                               proseW, 3, pl);
    int16_t y = ovlVerdProseY;
    for (int8_t i = 0; i < pn; ++i) {
      textBox(ovlPadX, y, proseW, ovlVerdLead, theme::bg, FONT_BODY, theme::text,
              TL_DATUM, pl[i]);
      y += ovlVerdLead;
    }

    // The reference's coloured closing line, under the prose.
    textBox(ovlPadX, ovlVerdAccentY,
            overlayTextR(ovlVerdAccentY + ovlVerdAccentH) - ovlPadX, ovlVerdAccentH,
            theme::bg, FONT_BODY, accent, TL_DATUM,
            m.overlay == kOverlaySuccess ? "Liberty prevails. Well done."
                                         : "Super Earth endures.");

    // The two rows this device has and a marketing mockup does not: how far
    // the objectives got, and what the order paid. On a failure the first is
    // the only place a near miss is visible at all, and "3/4 objectives met"
    // is a materially different evening from "0/4".
    //
    // Both are terse because they sit at the bottom of the trapezoid, where
    // the slant has taken the column to 216px: the ratio replaces "n OF n",
    // and the payout leans on the plus sign and the accent colour instead of
    // spelling out AWARDED. tools/check_layout.py holds both to that width.
    const int16_t statW = overlayTextR(ovlVerdStatY + 2 * ovlVerdStatH) - ovlPadX;
    int16_t sy = ovlVerdStatY;
    if (o.taskCount > 0) {
      char s[48];
      snprintf(s, sizeof(s), "%d/%d OBJECTIVES MET", done, (int)o.taskCount);
      textBox(ovlPadX, sy, statW, ovlVerdStatH, theme::bg, FONT_BODY, theme::text,
              ML_DATUM, s);
      sy += ovlVerdStatH;
    }
    if (m.overlay == kOverlaySuccess && o.rewardAmount > 0) {
      char s[48];
      snprintf(s, sizeof(s), "+%d MEDALS", (int)o.rewardAmount);
      textBox(ovlPadX, sy, statW, ovlVerdStatH, theme::bg, FONT_BODY, accent,
              ML_DATUM, s);
    }

    // The reference's star row: five between two bar flashes. Lit to how much
    // of the order was met rather than all five always, so the row carries the
    // same number the line above it does instead of being decoration -- and so
    // a failure with three of four met does not show an empty rank.
    const int16_t scx = (ovlPadX + overlayTextR(ovlVerdStarY)) / 2;
    const int16_t s0 = scx - 2 * ovlVerdStarGap;
    const int8_t lit =
        o.taskCount > 0 ? (int8_t)((done * 5 + o.taskCount / 2) / o.taskCount)
                        : (int8_t)(m.overlay == kOverlaySuccess ? 5 : 0);
    for (int8_t i = 0; i < 5; ++i)
      drawStar(s0 + i * ovlVerdStarGap, ovlVerdStarY, ovlVerdStarR,
               i < lit ? accent : mute);
    drawWingBars(s0 - ovlVerdStarR - 8, ovlVerdStarY, 18, -1, accent);
    drawWingBars(scx + 2 * ovlVerdStarGap + ovlVerdStarR + 8, ovlVerdStarY, 18, +1,
                 accent);

    // --- the way out -------------------------------------------------------
    textBox(ovlPadX, ovlVerdDismissY,
            overlayTextR(ovlVerdDismissY + ovlVerdDismissH) - ovlPadX,
            ovlVerdDismissH, theme::bg, FONT_LABEL, mute, ML_DATUM,
            "TOUCH TO DISMISS");

    // The hatched band across the foot, as both verdict references have. Cut
    // to the width the panel has at its very last row, so the two pixels the
    // edge leans over the band's own height read as clearance rather than as
    // the hatch running into the divider.
    const int16_t bandY = screenH - ovlBandH;
    const int16_t bandW = overlayEdgeX(screenH - 1) - 1;
    _tft.drawFastHLine(1, bandY - 1, bandW, accent);
    drawHazardBar(1, bandY, bandW, ovlBandH - 1, dim);
  }

  _tft.setTextDatum(TL_DATUM);
}

// The one-day bulletin: hud_bulletin_art.h blown up to the full 480x320
// through the same srcCoord()/lerp565() pair drawOverlayArt() and drawBiome()
// use, and nothing else on top of it but the way out.
//
// Full-bleed on purpose. The three Major Order overlays are compositions --
// text column, angled divider, art plate cropped by it -- because the
// renderer is what turns an assignment into a screen. This card arrived as a
// screen. Wrapping the HUD's own header and rules around a graphic that
// already has a header and rules of its own would be drawing it twice, so
// the layout here is: the card, edge to edge, at 1.6x.
//
// The scale is fractional and the loop does not care -- srcCoord() is a
// general rescale in 24.8 fixed point, not a doubling. What it does cost is
// pixels: 153,600 of them against drawOverlayArt()'s 76,800, two lerps each.
// That is a few hundred ms once, on a screen that then sits still until it is
// touched, so it is left as the same straightforward per-row scaler rather
// than something cleverer.
void HUDRenderer::drawBulletinOverlay() {
  // pushImage() streams the buffer straight at the panel, which wants each
  // pixel MSB first; the words below are native-endian.
  const bool swap = _tft.getSwapBytes();
  _tft.setSwapBytes(true);

  uint16_t line[screenW];
  for (int16_t j = 0; j < screenH; ++j) {
    const int32_t fy = srcCoord(j, bulletinart::kH, screenH);
    const int32_t y0 = fy >> 8;
    const int32_t y1 = (y0 + 1 < bulletinart::kH) ? y0 + 1 : y0;
    const int ty = fy & 0xFF;
    const uint16_t *r0 = &bulletinart::card[y0 * bulletinart::kW];
    const uint16_t *r1 = &bulletinart::card[y1 * bulletinart::kW];

    for (int16_t i = 0; i < screenW; ++i) {
      const int32_t fx = srcCoord(i, bulletinart::kW, screenW);
      const int32_t x0 = fx >> 8;
      const int32_t x1 = (x0 + 1 < bulletinart::kW) ? x0 + 1 : x0;
      const int tx = fx & 0xFF;
      line[i] =
          lerp565(lerp565(pgm_read_word(&r0[x0]), pgm_read_word(&r0[x1]), tx),
                  lerp565(pgm_read_word(&r1[x0]), pgm_read_word(&r1[x1]), tx),
                  ty);
    }
    _tft.pushImage(0, j, screenW, 1, line);
  }

  _tft.setSwapBytes(swap);

  // Same line, same font, same reason as the other three: nothing clears this
  // on a timer, so the instruction is the whole affordance. Dropped into the
  // black strip the crop was chosen to keep -- see ovlBulHint* in config.h --
  // rather than in the reference's foot position, which on this card is
  // occupied by the card's own closing line.
  textBox(ovlBulHintX, ovlBulHintY, ovlBulHintW, ovlBulHintH, theme::bg,
          FONT_LABEL, theme::goldMute, ML_DATUM, "TOUCH TO DISMISS");

  _tft.setTextDatum(TL_DATUM);
}

void HUDRenderer::update(const HudModel &m, time_t nowUtc) {
  // An overlay owns the panel outright: no chrome, no carousel, no clocks.
  // Repainted only when the announcement itself changes, so the screen is
  // static while it waits to be acknowledged.
  if (m.overlay != kOverlayNone) {
    const String sig = String((int)m.overlay) + "|" + String((int)m.overlaySubject.id);
    if (sig != _overlaySig) {
      _overlaySig = sig;
      drawOverlay(m, nowUtc);
    }
    return;
  }
  // Leaving an overlay means everything underneath it has been painted over.
  if (_overlaySig.length()) {
    _overlaySig = "";
    invalidate();
  }

  if (!_chromeDrawn) {
    _tft.fillScreen(theme::bg);
    drawFrame();
    // The rest is left to drawBody(), which is about to run: the cleared
    // _contentSig guarantees it.
    _chromeDrawn = true;
    _contentSig = "";
    _targetSig = "";
    _campaignSig = "";
    _wifiSig = -1;
  }

  updateCarousel(m);

  // A page-type crossing (MO card <-> campaign card) needs the full drawBody()
  // repaint even when contentSignature(m) itself didn't change -- the two card
  // types use different header/footer geometry, and nothing else here notices
  // "only which page we're looking at changed."
  const bool cardModeNow = pageIsCard(m, _pageIdx);
  const bool boundaryCrossed = cardModeNow != _lastCardMode;

  const String sig = contentSignature(m);
  if (sig != _contentSig || boundaryCrossed) {
    _contentSig = sig;
    drawBody(m, nowUtc);
  } else if (_cardMode && targetSignature(m, _pageIdx) != _targetSig) {
    // The carousel moved within the MO's own targets, or this target's data did.
    drawCard(m);
  } else if (!_cardMode && pageCount(m) > 0) {
    // As in drawBody(): campaign pages only exist with no order active, so
    // the page index is the campaign index.
    const uint8_t ci = _pageIdx;
    const String csig = campaignPageSignature(m, ci);
    if (csig != _campaignSig) {
      _campaignSig = csig;
      drawCampaignBody(m, m.campaigns[ci], m.campaignHistory[ci]);
    }
  }

  _lastCardMode = cardModeNow;

  // After the branch above, not before: a drawBody() repaint clears the row
  // this paints into. Its own signature makes the second call a no-op on the
  // frames where drawBody() already ran, and on a carousel step -- where none
  // of the branches above touch the header -- it is the only thing that moves
  // the pips.
  drawHeader(m);
  if (_cardMode) drawCardClocks(m, nowUtc);
  drawFooter(m, nowUtc);
  drawWifi(m.wifiUp);
}

void HUDRenderer::showBoot(const char *status) {
  invalidate();
  _cardMode = false;
  _tft.fillScreen(theme::bg);
  drawFrame();
  drawStatusHeader();
  // The Helldivers II title mark, boot screen only -- the idle screen keeps
  // the SEAF emblem as its own centrepiece. Cut at the full 440px content
  // width so it carries the screen; only scaled and recoloured, never redrawn.
  _tft.drawBitmap(padX, 48, icons::hd2LogoBoot, icons::hd2LogoBootW,
                  icons::hd2LogoBootH, theme::gold);
  textBox(padX, 232, contentW, 22, theme::bg, FONT_VALUE, theme::text, MC_DATUM,
          F("MAJOR ORDER MONITOR"));
  textBox(padX, 264, contentW, 20, theme::bg, FONT_BODY, theme::grey, MC_DATUM,
          String(status));
  // Next update() must repaint from scratch.
  _chromeDrawn = false;
}

void HUDRenderer::showPortal(const char *ssid, const char *pass) {
  invalidate();
  _cardMode = false;
  _tft.fillScreen(theme::bg);
  drawFrame();
  drawStatusHeader();
  textBox(padX, 60, contentW, 30, theme::bg, FONT_DISPLAY, theme::gold, MC_DATUM,
          F("WIFI SETUP"));
  textBox(padX, 104, contentW, 20, theme::bg, FONT_BODY, theme::text, MC_DATUM,
          F("Join this network from a phone or laptop,"));
  textBox(padX, 124, contentW, 20, theme::bg, FONT_BODY, theme::text, MC_DATUM,
          F("then set WiFi and UTC offset in the page that opens."));

  drawStatBox(padX, statY, kStatW, statH, F("NETWORK"), String(ssid), theme::gold);
  drawStatBox(padX + kStatW + statGap, statY, kStatW, statH, F("PASSWORD"),
              String(pass), theme::gold);

  textBox(padX, 224, contentW, 20, theme::bg, FONT_BODY, theme::grey, MC_DATUM,
          F("If no page opens, browse to 192.168.4.1"));
  _chromeDrawn = false;
}

// ---------------------------------------------------------------------------
//  The two touch calibration screens
//
//  Traced from touch_required_reference.jpg and touch_success_reference.jpg:
//  a destroyer bridge, the HELLDIVERS II mark centred over it, and one card
//  below that -- amber with a reticle to ask for a calibration, green with a
//  service medallion to confirm one. Everything the two share is drawn by the
//  same code and coloured by the caller; see the cal* constants in config.h
//  for the geometry and for where this deliberately departs from the art.
//
//  Drawn from primitives rather than added to hud_icons.h. A 92px reticle as a
//  1-bit bitmap is 1,058 bytes of an image already sitting at 96% of its flash
//  slot, for a shape that is two circles and eight straight runs; the hazard
//  hatch could not be a bitmap at all without storing it at full width; and
//  the wordmark is scaled from the cut the boot screen already carries rather
//  than stored a second time at this size.
//
//  What the panel does not get, and could not: the reference's photographic
//  bridge, the bloom around the wordmark, and the diver as a full figure. The
//  first two are gradients over most of a frame and there is no framebuffer to
//  composite them in; the third has nowhere to stand once the card is as wide
//  as legible 9pt copy makes it.
// ---------------------------------------------------------------------------

// The colour drawBridge() leaves at (x,y), for the wordmark's anti-aliased
// edges to blend against. Only the three tones the wordmark can land on --
// space, the planet, and the planet's limb -- because the wordmark's box is
// clear of the ship structure by construction (see calLogoY).
uint16_t HUDRenderer::bridgeAt(int16_t x, int16_t y) {
  const int32_t dx = x - calDiscX, dy = y - calDiscY;
  const int32_t d2 = dx * dx + dy * dy;
  if (d2 > (int32_t)calDiscR * calDiscR) return theme::voidBlue;
  // Two 1px rings, so the limb survives the panel's own subpixel structure.
  if (d2 > (int32_t)(calDiscR - 2) * (calDiscR - 2)) return theme::discRim;
  return theme::discFill;
}

// The bridge itself: space, the planet in the viewport, the ship's structure
// around the frame, and the diver watching from the left.
//
// Five flat tones and no gradients. The reference is a photograph, and the
// honest options at 480x320 with no framebuffer are a flat impression of it or
// nothing at all -- so this is the impression: what is in it, and roughly
// where, at the reference's own proportions.
void HUDRenderer::drawBridge() {
  _tft.fillScreen(theme::voidBlue);

  // The planet. Its lit limb breaks the top of the screen and the rest of it
  // goes behind the card, which is what the reference does with it too.
  _tft.fillCircle(calDiscX, calDiscY, calDiscR, theme::discFill);
  _tft.drawCircle(calDiscX, calDiscY, calDiscR, theme::discRim);
  _tft.drawCircle(calDiscX, calDiscY, calDiscR - 1, theme::discRim);

  // Ceiling beam and two struts hanging off it. Kept above y=10 so the
  // wordmark never has to blend against them -- see bridgeAt().
  _tft.fillRect(0, 0, screenW, 9, theme::hull);
  _tft.drawFastHLine(0, 9, screenW, theme::hullEdge);
  _tft.fillRect(118, 10, 4, 13, theme::hull);
  _tft.fillRect(358, 10, 4, 13, theme::hull);

  // The consoles either side of the card, and the deck under it. These are the
  // only things holding the card off the edges of the panel, so they run the
  // card's own height rather than the reference's full frame.
  _tft.fillRect(0, 58, 16, 218, theme::hull);
  _tft.fillRect(screenW - 16, 58, 16, 218, theme::hull);
  _tft.drawFastVLine(15, 58, 218, theme::hullEdge);
  _tft.drawFastVLine(screenW - 16, 58, 218, theme::hullEdge);
  _tft.fillRect(0, 301, screenW, screenH - 301, theme::hull);
  _tft.drawFastHLine(0, 300, screenW, theme::hullEdge);

  // The diver: cape, shoulders with the yellow pauldron, and a helmet whose
  // crown catches the light. Seen from behind and facing into the screen, as
  // in the reference, and running off the bottom of its box into the card's
  // top edge the way the reference's runs off the bottom of the frame.
  //
  // The pauldron and the crown are the whole reason this reads as anything.
  // Everything else here is one near-black on another, at 48px, in a corner --
  // the two scraps of yellow are what say armour rather than smudge, and they
  // are what the eye actually picks the figure out by in the reference too.
  const int16_t hx = calDiverX + calDiverW / 2, hy = calDiverY + 19;
  _tft.fillRect(calDiverX, calDiverY + 36, 12, calDiverH - 36, theme::diverInk);
  _tft.fillCircle(calDiverX + 10, calDiverY + 40, 8, theme::diverInk);
  _tft.fillCircle(calDiverX + 38, calDiverY + 40, 8, theme::diverInk);
  _tft.fillRect(calDiverX + 10, calDiverY + 40, 28, calDiverH - 40, theme::diverInk);
  _tft.fillRect(hx - 7, hy + 11, 14, 9, theme::diverInk);   // neck
  _tft.fillRect(calDiverX + 30, calDiverY + 36, 12, 9, theme::goldMute);  // pauldron

  // Crown then helmet, not helmet then crown: a filled disc overpainted by a
  // second one dropped 4px leaves a crescent along the top, where an arc ring
  // walked by angle over the same band came out visibly stippled at r=15.
  _tft.fillCircle(hx, hy, 15, theme::goldMute);
  _tft.fillCircle(hx, hy + 4, 14, theme::diverInk);
  _tft.fillRect(hx + 2, hy + 1, 11, 6, theme::voidBlue);    // visor slot
}

// The HELLDIVERS II mark, scaled into (x,y,w,h) and blended onto the bridge.
//
// hud_icons.h already carries this art at 440x172 for the boot screen, which
// is 2.6x the height this band has. Box-filtered down rather than cut a second
// time: another PROGMEM copy is ~1.4KB of a flash slot at 96%, and this is
// code, which the slot has more room for than data. Nearest-neighbour at this
// ratio was tried first and eats the wing slots and the skull's eye sockets
// outright -- every one of them is under a source pixel wide at the
// destination, so which way they round is a coin toss per column.
//
// Each destination pixel averages the source rectangle it covers and the
// coverage drives a blend from the bridge behind it to `ink`, which is why
// this needs bridgeAt() rather than a background colour: the planet's limb
// passes straight through the mark.
void HUDRenderer::drawWordmark(int16_t x, int16_t y, int16_t w, int16_t h,
                               uint16_t ink) {
  const int16_t sw = icons::hd2LogoBootW, sh = icons::hd2LogoBootH;
  const int16_t stride = (sw + 7) / 8;
  const int16_t ir = (ink >> 11) & 0x1F, ig = (ink >> 5) & 0x3F, ib = ink & 0x1F;

  for (int16_t dy = 0; dy < h; dy++) {
    const int16_t sy0 = (int16_t)(((int32_t)dy * sh) / h);
    int16_t sy1 = (int16_t)(((int32_t)(dy + 1) * sh) / h);
    if (sy1 <= sy0) sy1 = sy0 + 1;
    for (int16_t dx = 0; dx < w; dx++) {
      const int16_t sx0 = (int16_t)(((int32_t)dx * sw) / w);
      int16_t sx1 = (int16_t)(((int32_t)(dx + 1) * sw) / w);
      if (sx1 <= sx0) sx1 = sx0 + 1;

      int16_t on = 0, total = 0;
      for (int16_t sy = sy0; sy < sy1; sy++) {
        const uint8_t *row = icons::hd2LogoBoot + (int32_t)sy * stride;
        for (int16_t sx = sx0; sx < sx1; sx++, total++)
          if (row[sx >> 3] & (0x80 >> (sx & 7))) on++;
      }
      if (!on) continue;  // clear of the mark; leave the bridge alone

      const uint16_t under = bridgeAt(x + dx, y + dy);
      const int16_t ur = (under >> 11) & 0x1F, ug = (under >> 5) & 0x3F;
      const int16_t ub = under & 0x1F;
      const int16_t r = ur + ((ir - ur) * on) / total;
      const int16_t g = ug + ((ig - ug) * on) / total;
      const int16_t b = ub + ((ib - ub) * on) / total;
      _tft.drawPixel(x + dx, y + dy, (uint16_t)((r << 11) | (g << 5) | b));
    }
  }
}

// A ring segment between rIn and rOut, from a0 to a1 degrees measured from +x
// with y downward. Walked by angle rather than over a bounding box: one step
// per pixel of the outer circumference leaves no gaps, where the box version
// wants an atan2() per pixel of a rectangle that is mostly outside the ring.
void HUDRenderer::drawArcRing(int16_t cx, int16_t cy, int16_t rIn, int16_t rOut,
                              float a0, float a1, uint16_t c) {
  constexpr float kDeg = 0.01745329252f;
  const float step = rOut > 0 ? 1.0f / (float)rOut : 0.1f;
  for (float a = a0 * kDeg; a <= a1 * kDeg; a += step) {
    const float ca = cosf(a), sa = sinf(a);
    for (int16_t r = rIn; r <= rOut; r++)
      _tft.drawPixel(cx + (int16_t)lroundf(ca * r), cy + (int16_t)lroundf(sa * r), c);
  }
}

// A filled five-pointed star, point up, in the medallion's rank row.
//
// The ten vertices are a table rather than five cosines: they are the same
// angles every time this is called, and at r=4 the whole shape is eight pixels
// across -- computing it would cost more than storing it.
void HUDRenderer::drawStar(int16_t cx, int16_t cy, int16_t r, uint16_t c) {
  static const int8_t kUnit[10][2] = {
      {0, -100}, {25, -34}, {95, -31},  {40, 13},  {59, 81},
      {0, 42},   {-59, 81}, {-40, 13},  {-95, -31}, {-25, -34}};
  int16_t px[10], py[10];
  for (uint8_t i = 0; i < 10; i++) {
    px[i] = cx + (int16_t)((kUnit[i][0] * r) / 100);
    py[i] = cy + (int16_t)((kUnit[i][1] * r) / 100);
  }
  for (uint8_t i = 0; i < 10; i++)
    _tft.fillTriangle(cx, cy, px[i], py[i], px[(i + 1) % 10], py[(i + 1) % 10], c);
}

// Everything the two calibration cards have in common: the panel and its
// border, the chip and title in the header band, the rule under it, and the
// hatched band across the foot with its text plate.
//
// The caller supplies the accent (gold or lime), the dimmed accent for the
// hatch, the two strings, and `check` -- which picks the chip's mark, and with
// it the wing flashes either side of the band text. Only the body between the
// rules differs between the screens, and that is the caller's to fill.
void HUDRenderer::drawCalCard(uint16_t accent, uint16_t dim, const String &title,
                              const String &bandText, bool check) {
  _tft.fillRect(calCardX, calCardY, calCardW, calCardH, theme::panel);
  _tft.drawRect(calCardX, calCardY, calCardW, calCardH, accent);
  const int16_t inX = calCardX + 1, inW = calCardW - 2;
  const int16_t headRuleY = calCardY + calHeadH;
  const int16_t stripeY = calCardY + calCardH - calStripeH;

  // --- header: chip, title, rule -------------------------------------------
  const int16_t badgeX = calCardX + calBadgeInset;
  const int16_t badgeY = calCardY + 1 + (calHeadH - 1 - calBadgeH) / 2;
  // A tab whose trailing edge leans outward on the way down, so it is wider at
  // its foot than at its head. The slant is what stops it reading as a plain
  // rectangle at 40px, and its direction is the reference's.
  _tft.fillRect(badgeX, badgeY, calBadgeW - calBadgeSlant, calBadgeH, accent);
  _tft.fillTriangle(badgeX + calBadgeW - calBadgeSlant, badgeY,
                    badgeX + calBadgeW - calBadgeSlant, badgeY + calBadgeH - 1,
                    badgeX + calBadgeW, badgeY + calBadgeH - 1, accent);

  // The mark is knocked out of the tab in the card's own fill colour and then
  // detailed back in the accent -- accent-on-dark-on-accent, which is how both
  // references build their chips.
  const int16_t tcx = badgeX + (calBadgeW - calBadgeSlant) / 2;
  const int16_t tcy = badgeY + calBadgeH / 2;
  if (check) {
    _tft.fillCircle(tcx, tcy, 10, theme::panel);
    // A 3px pen walked down and then up, one pixel per step. Two runs of
    // squares, not two triangle pairs: at this size a quad's ends land on
    // whichever side of a half-pixel the rounding picks, and the short arm
    // comes out a different weight from the long one.
    for (int16_t i = 0; i < 5; i++)
      _tft.fillRect(tcx - 7 + i, tcy - 2 + i, 3, 3, accent);
    for (int16_t i = 0; i < 9; i++)
      _tft.fillRect(tcx - 4 + i, tcy + 3 - i, 3, 3, accent);
  } else {
    const int16_t tTop = badgeY + 5, tBot = badgeY + calBadgeH - 5;
    _tft.fillTriangle(tcx, tTop, tcx - 11, tBot, tcx + 11, tBot, theme::panel);
    _tft.fillRect(tcx - 1, tTop + 8, 3, 7, accent);
    _tft.fillRect(tcx - 1, tBot - 4, 3, 3, accent);
  }

  // Label weight, not value weight: "TOUCH CALIBRATION SUCCESSFUL" is 421px at
  // FONT_VALUE and there are 364 to put it in -- and label weight is also the
  // proportionally right answer, the reference's header caps being about 7.5%
  // of the card's height, which on 190px is the ~13px FreeSansBold9pt gives.
  const int16_t titleX = badgeX + calBadgeW + calTitleGap;
  textBox(titleX, badgeY, calCardX + calCardW - calTextPadR - titleX, calBadgeH,
          theme::panel, FONT_LABEL, accent, ML_DATUM, title);
  _tft.drawFastHLine(inX, headRuleY, inW, accent);

  // --- the hatched band ----------------------------------------------------
  // stripeY-1 is the rule; the hatch runs from stripeY down to the row above
  // the card's bottom border, which is calStripeH-1 rows in all.
  _tft.drawFastHLine(inX, stripeY - 1, inW, accent);
  drawHazardBar(inX, stripeY, inW, calStripeH - 1, dim);

  // The band's text sits on a plate of the screen's own background so the
  // hatch does not run through the letterforms, as in both references.
  const int16_t bandY = stripeY + (calStripeH - 1 - calBandTextH) / 2;
  textBox(calBandTextX, bandY, calBandTextW, calBandTextH, theme::bg, FONT_LABEL,
          accent, MC_DATUM, bandText);

  if (!check) return;

  // Three-bar wing flashes either side of "FOR SUPER EARTH!", stepping shorter
  // as they go outward. Measured off the string rather than placed at a fixed
  // x: the plate is wider than the text and marks pinned to the plate's edges
  // would sit in open background instead of against the words.
  _tft.setFreeFont(FONT_LABEL);
  const int16_t half = _tft.textWidth(bandText.c_str()) / 2;
  const int16_t cx = calBandTextX + calBandTextW / 2;
  const int16_t my = bandY + calBandTextH / 2;
  const int16_t bar[3] = {14, calMarkW, 14};
  for (uint8_t i = 0; i < 3; i++) {
    const int16_t row = my - 4 + i * 3;
    _tft.fillRect(cx - half - calMarkGap - bar[i], row, bar[i], 2, accent);
    _tft.fillRect(cx + half + calMarkGap, row, bar[i], 2, accent);
  }
}

// A reticle with a hand tapping its centre, in an `s`-square box at (x,y).
// Ring, four crosshair ticks through it, a small target at the middle, and a
// bracket at each corner of the box -- the reference's own construction. The
// hand comes in from the lower right at 45 degrees with the fingertip on the
// centre dot, which is what makes it read as "put a finger here" rather than
// as a target to be shot at; a hand standing upright in the middle of the ring
// reads as a raised finger and nothing else.
//
// Sized in fractions of `s` only where the fraction is the point. The rest is
// in pixels: this is one icon at one size, and naming a constant for the
// fingertip's offset would suggest it means something elsewhere.
void HUDRenderer::drawCalReticle(int16_t x, int16_t y, int16_t s) {
  const int16_t cx = x + s / 2, cy = y + s / 2;
  const int16_t r = s * 13 / 40;  // 29 at s=92, leaving the ticks room outside

  // Three concentric circles: a 1px ring at this diameter is a dotted line by
  // the time the panel's own subpixel structure has had it, and the reference's
  // ring is heavy enough to carry the icon on its own.
  for (int16_t i = 0; i < 3; i++) _tft.drawCircle(cx, cy, r - i, theme::gold);

  // Crosshair ticks, crossing the ring rather than stopping outside it.
  const int16_t t0 = r - 6, t1 = r + 9, tw = t1 - t0;
  _tft.fillRect(cx - 1, cy - t1, 3, tw, theme::gold);
  _tft.fillRect(cx - 1, cy + t0, 3, tw, theme::gold);
  _tft.fillRect(cx - t1, cy - 1, tw, 3, theme::gold);
  _tft.fillRect(cx + t0, cy - 1, tw, 3, theme::gold);

  // The target at the middle, which is what the finger is pointing at.
  _tft.drawCircle(cx, cy, 10, theme::gold);
  _tft.drawCircle(cx, cy, 9, theme::gold);
  _tft.fillCircle(cx, cy, 3, theme::gold);

  // Corner brackets, 2px thick, drawn as pairs of runs -- there is no
  // drawLine() here and none is needed for right angles.
  //
  // Three of them, not four: the hand comes in over the bottom-right corner
  // and covers it, exactly as it does in the reference. Drawing one there and
  // letting the hand's halo bite a piece out of it looks like damage.
  const int16_t b = 15, x1 = x + s - 1, y1 = y + s - 1;
  for (int16_t i = 0; i < 2; i++) {
    _tft.drawFastHLine(x, y + i, b, theme::gold);
    _tft.drawFastVLine(x + i, y, b, theme::gold);
    _tft.drawFastHLine(x1 - b + 1, y + i, b, theme::gold);
    _tft.drawFastVLine(x1 - i, y, b, theme::gold);
    _tft.drawFastHLine(x, y1 - i, b, theme::gold);
    _tft.drawFastVLine(x + i, y1 - b + 1, b, theme::gold);
  }

  // The hand, drawn twice: once in the card's own fill, three pixels proud all
  // round, then in gold on top of that. The halo is not decoration -- the hand
  // crosses the ring and the bottom-right bracket, and without a gap the three
  // gold shapes merge into one blob. The reference solves the same problem by
  // outlining the hand in black.
  for (int8_t pass = 0; pass < 2; pass++) {
    const uint16_t c = pass ? theme::gold : theme::panel;
    const int16_t g = pass ? 0 : 2;

    // Index finger: a bar at 45 degrees, from the centre dot down to the
    // knuckles. Two triangles, because a quad is what four points make and
    // there is no primitive for one.
    const int16_t ax = cx - g, ay = cy + 4;
    const int16_t bx = cx + 4, by = cy - g;
    const int16_t px = cx + 22 + g, py = cy + 16;
    const int16_t qx = cx + 16, qy = cy + 22 + g;
    _tft.fillTriangle(ax, ay, bx, by, px, py, c);
    _tft.fillTriangle(ax, ay, px, py, qx, qy, c);
    _tft.fillCircle(cx + 2, cy + 2, 2 + g, c);  // rounded fingertip

    // Folded fingers and palm: a rounded block below and right of that, and a
    // thumb bump on the near side.
    const int16_t hx = cx + 12 - g, hy = cy + 13 - g;
    const int16_t hw = 25 + 2 * g, hh = 23 + 2 * g, hr = 6 + g;
    _tft.fillRect(hx + hr, hy, hw - 2 * hr, hh, c);
    _tft.fillRect(hx, hy + hr, hw, hh - 2 * hr, c);
    _tft.fillCircle(hx + hr, hy + hr, hr, c);
    _tft.fillCircle(hx + hw - hr - 1, hy + hr, hr, c);
    _tft.fillCircle(hx + hr, hy + hh - hr - 1, hr, c);
    _tft.fillCircle(hx + hw - hr - 1, hy + hh - hr - 1, hr, c);
    _tft.fillCircle(cx + 10, cy + 31, 6 + g, c);
  }
}

// The service medallion, in an `s`-square box at (x,y): three fins, a laurel
// wreath around a globe, and a rank row of five stars under it. The success
// card's answer to the required card's reticle, and the same box.
//
// Proportioned off the reference rather than off round numbers -- fins a
// seventh of the box, wreath two thirds, stars a sixth -- because the three
// parts are what identify it, and a wreath drawn to fill the box swallows the
// other two.
void HUDRenderer::drawCalMedallion(int16_t x, int16_t y, int16_t s) {
  const int16_t cx = x + s / 2;
  const int16_t cy = y + 42;  // fins above, stars below; see the ratios above
  const int16_t r = 19;       // the globe; the wreath adds 11 outside it

  // The crest, in the silver the reference has it in rather than the wreath's
  // gold. Drawn first and overlapping the globe, so the disc paints over the
  // feet and the three fins read as standing behind it -- which at 15px is the
  // whole difference between a crest and three loose triangles floating above
  // a ball.
  _tft.fillTriangle(cx, y + 13, cx - 5, y + 28, cx + 5, y + 28, theme::text);
  _tft.fillTriangle(cx - 10, y + 17, cx - 14, y + 28, cx - 6, y + 28, theme::text);
  _tft.fillTriangle(cx + 10, y + 17, cx + 6, y + 28, cx + 14, y + 28, theme::text);

  // The globe: a pale disc, the graticule, then the landmasses over it.
  //
  // That order is the point. Drawn the other way round -- grid last, over
  // everything -- 38px of white disc under three dark meridians and three dark
  // latitudes reads as a beach ball, because the grid is then the highest-
  // contrast thing in the icon and the continents are just tint between its
  // cells. Painting the land last makes the grid the ocean's texture and the
  // continents the shapes, which is what the reference's globe is.
  _tft.fillCircle(cx, cy, r, theme::text);

  // Latitudes are chords, so each one is as long as the sphere is wide there;
  // meridians are drawn as straight verticals at the same three fractions of
  // the radius, which at 38px across is indistinguishable from the ellipses a
  // real projection would want and is four runs instead of a per-pixel solve.
  for (int8_t k = -1; k <= 1; k++) {
    const int16_t dy = k * 10;
    const int16_t half = (int16_t)lroundf(sqrtf((float)(r * r - dy * dy)));
    _tft.drawFastHLine(cx - half, cy + dy, 2 * half + 1, theme::grey);
  }
  _tft.drawFastVLine(cx, cy - r, 2 * r + 1, theme::grey);
  for (int8_t k = -1; k <= 1; k += 2) {
    const int16_t dx = k * r / 2;
    const int16_t half = (int16_t)lroundf(sqrtf((float)(r * r - dx * dx)));
    _tft.drawFastVLine(cx + dx, cy - half, 2 * half + 1, theme::grey);
  }

  // Landmasses, in overlapping pairs rather than one circle each: a lone disc
  // reads as a dot at this size, and two of them off-centre gives an edge that
  // is not an arc, which is the only cue that says coastline.
  _tft.fillCircle(cx - 6, cy - 6, 5, theme::cardEdge);
  _tft.fillCircle(cx - 2, cy - 2, 4, theme::cardEdge);
  _tft.fillCircle(cx + 6, cy + 2, 5, theme::cardEdge);
  _tft.fillCircle(cx + 3, cy + 8, 3, theme::cardEdge);
  _tft.fillCircle(cx - 8, cy + 7, 3, theme::cardEdge);
  _tft.drawCircle(cx, cy, r, theme::grey);

  // The wreath: two nested crescents open at the top, gold.
  //
  // Both ends stop short of horizontal (12 degrees below it on the outer arm,
  // 30 on the inner). An earlier cut ran the outer one from -12 to 192, i.e.
  // up past the globe's equator on both sides, and the two tips curling up
  // above the widest point turned the pair into a chain necklace. Leaves are
  // gone with them -- eight dots threaded between the arms at r+8 were what
  // made the links.
  drawArcRing(cx, cy, r + 4, r + 6, 12.f, 168.f, theme::gold);
  drawArcRing(cx, cy, r + 9, r + 11, 30.f, 150.f, theme::gold);

  // Rank row. Five, as in the reference, and small enough that the row reads
  // as one element rather than as five things.
  for (int8_t i = 0; i < 5; i++)
    drawStar(cx - 24 + i * 12, y + 82, 4, theme::text);
}

// The diagonal hazard band along the card's bottom edge, hatched in `ink`.
//
// Built as one horizontal run per row rather than as diagonal lines: at 45
// degrees a stripe's start moves exactly one pixel per row, so the whole band
// is a stack of offset runs -- which is both what the available primitives can
// draw and faster than the general case would be.
//
// Thin lines widely spaced, not the bold alternating stripes a hazard bar
// usually means: both references hatch this band at roughly a fifth duty in a
// dimmed version of the card's accent, so it stays a texture behind the band's
// text instead of competing with it. The success screen is the reason this
// takes a colour -- green stripes at gold's weight read as damage.
void HUDRenderer::drawHazardBar(int16_t x, int16_t y, int16_t w, int16_t h,
                                uint16_t ink) {
  _tft.fillRect(x, y, w, h, theme::bg);
  for (int16_t row = 0; row < h; row++) {
    // Stripes lean up-and-to-the-right, so their start walks left as the row
    // walks down. The modulo keeps the first one on screen for wide bars.
    for (int16_t sx = -(row % calStripePitch) - calStripePitch; sx < w;
         sx += calStripePitch) {
      int16_t a = sx, b = sx + calStripeInk;
      if (b <= 0 || a >= w) continue;
      if (a < 0) a = 0;
      if (b > w) b = w;
      _tft.drawFastHLine(x + a, y + row, b - a, ink);
    }
  }
}

// The five rows of copy to the right of the card's icon: a coloured salutation
// and two two-line paragraphs, at the same rhythm on both screens.
//
// TL_DATUM, unlike everything else on the panel -- see the note over the
// calAddrDy/calLineH constants. These are the HUD's only mixed-case rows and
// the middle datum's ascent-only centring drops their descenders out of the
// sprite unless the rows are made a third taller than the type needs.
void HUDRenderer::drawCalCopy(uint16_t headColor, const String &head,
                              const String &l1, const String &l2,
                              const String &l3, const String &l4) {
  const int16_t bodyY = calCardY + calHeadH + 1;
  const int16_t textX = calCardX + calIconInset + calIconS + calTextGap;
  const int16_t textW = calCardX + calCardW - calTextPadR - textX;

  textBox(textX, bodyY + calAddrDy, textW, calAddrH, theme::panel, FONT_LABEL,
          headColor, TL_DATUM, head);

  // Both paragraphs in the same white. The first draft dimmed the second to
  // theme::grey the way the HUD's own secondary rows are dimmed; both
  // references have them at one weight, and the card is small enough that the
  // dimmed pair read as a footnote rather than as the rest of the sentence.
  int16_t ly = bodyY + calCopyDy;
  textBox(textX, ly, textW, calLineH, theme::panel, FONT_BODY, theme::text,
          TL_DATUM, l1);
  ly += calLineH;
  textBox(textX, ly, textW, calLineH, theme::panel, FONT_BODY, theme::text,
          TL_DATUM, l2);
  ly += calLineH + calParaGap;
  textBox(textX, ly, textW, calLineH, theme::panel, FONT_BODY, theme::text,
          TL_DATUM, l3);
  ly += calLineH;
  textBox(textX, ly, textW, calLineH, theme::panel, FONT_BODY, theme::text,
          TL_DATUM, l4);
}

// Where the icon goes on both cards: centred in what is left of the card
// between the header rule and the band rule.
static inline int16_t calIconY() {
  const int16_t bodyY = calCardY + calHeadH + 1;
  const int16_t bodyH = calCardY + calCardH - calStripeH - 1 - bodyY;
  return bodyY + (bodyH - calIconS) / 2;
}

void HUDRenderer::showTouchPrompt() {
  invalidate();
  _cardMode = false;

  drawBridge();
  drawWordmark(calLogoX, calLogoY, calLogoW, calLogoH, theme::text);

  // The band text is the screen's only affordance, so it is named outright. It
  // does not promise the wait is unlimited, because it is not: main.cpp gives
  // this a bounded wait and boots on regardless, and a unit nobody was standing
  // in front of ends up on the HUD with the footer hint carrying the offer.
  //
  // In the band rather than under the card, which is where the earlier cut put
  // it. The reference has no such line at all -- its band carries a stencilled
  // legend -- and the band is the one place on this screen that belongs to
  // neither the card's message nor the bridge, so the instruction goes there
  // and the success screen's "FOR SUPER EARTH!" sits in the same slot.
  drawCalCard(theme::gold, theme::goldDim, F("TOUCH CALIBRATION REQUIRED"),
              F("TOUCH ANYWHERE TO BEGIN"), false);

  drawCalReticle(calCardX + calIconInset, calIconY(), calIconS);

  // Written for this panel rather than lifted from the reference: the wording
  // there is the game's, and this one has to say what this device actually
  // wants, which is a calibration and not a mission.
  drawCalCopy(theme::text, F("Helldiver,"), F("This terminal's touch interface is"),
              F("not yet calibrated."), F("Run a calibration to ensure accurate"),
              F("targeting and stratagem deployment."));

  _chromeDrawn = false;
}

void HUDRenderer::showTouchSuccess() {
  invalidate();
  _cardMode = false;

  drawBridge();
  drawWordmark(calLogoX, calLogoY, calLogoW, calLogoH, theme::text);
  drawCalCard(theme::lime, theme::limeDim, F("TOUCH CALIBRATION SUCCESSFUL"),
              F("FOR SUPER EARTH!"), true);

  drawCalMedallion(calCardX + calIconInset, calIconY(), calIconS);

  // The headline takes the card's accent where the required screen's takes
  // white: on that screen "Helldiver," is an address and the amber belongs to
  // the warning, and on this one the headline *is* the good news. Both
  // references do the same.
  drawCalCopy(theme::lime, F("Calibration Complete!"),
              F("Your touchscreen has been calibrated"), F("successfully."),
              F("Super Earth thanks you for your"), F("commitment to victory."));

  _chromeDrawn = false;
}
